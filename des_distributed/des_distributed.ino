// =============================================================================
// des_distributed.ino — ESP32 entry point for the generic distributed
//                       homomorphic DES supervisor
// =============================================================================
//
// All the logic lives in des_generic.h, which knows nothing about Arduino, the
// ESP32, or any particular plant. This file only does three things:
//
//   1. choose the deployment (which problem, which node, how many nodes)
//   2. bring up the IP link
//   3. call des_setup() / des_loop()
//
// Porting to a Linux gateway, an industrial PC or another MCU means replacing
// exactly this file — see host_main.cpp for a POSIX version.
//
// ── CONFIGURE PER BOARD ──────────────────────────────────────────────────────
// Flash each board with a different DES_NODE_ID, either by editing it below or
// with a build flag: arduino-cli compile --build-property "build.extra_flags=
// -DDES_NODE_ID=2".
// =============================================================================

// ── 1. which problem ────────────────────────────────────────────────────────
// Any header generated by the UltraDES notebook. All three in this repo are
// hard-linked into this folder, so nothing is duplicated and nothing can drift.
//   supervisor_data_small_factory.h           4 events,  1 supervisor
//   supervisor_data_extended_small_factory.h  6 events,  2 supervisors
//   supervisor_data_fms.h                    31 events,  7 supervisors
#define DES_DATA_HEADER "supervisor_data_fms.h"

// ── 2. this deployment ──────────────────────────────────────────────────────
#define DES_NODE_ID   2        // 1 .. DES_NUM_NODES — DIFFERENT ON EACH BOARD
#define DES_NUM_NODES 2

// Which synthesised family to distribute:
//   DES_FAMILY_LMOD      full local-modular: synthesised over the plant, so its
//                        state tracks the machines and the plant check catches
//                        every physically impossible uncontrollable event
//   DES_FAMILY_LMOD_RED  reduced local-modular (smallest and fastest, but it
//                        does not carry the plant: an impossible event may pass)
//   DES_FAMILY_MONO      the monolithic supervisor (all on one node; useful as
//                        the centralised baseline to measure against)
#define DES_FAMILY DES_FAMILY_LMOD

// Supervisor → node assignment. Omit for an even block partition, which keeps
// supervisors that share events together and so minimises the shared set.
// Explicit example for fms (7 supervisors) over 3 nodes:
//   #define DES_SUP_NODE_MAP {1,1,1,2,2,3,3}
// #define DES_SUP_NODE_MAP {1,2}

// Controllability is the one thing the generated header does not carry. Leave
// this out to infer it from the event labels ('a…' vs 'b…', else odd/even
// trailing digit) — the engine prints what it inferred at boot so you can
// check it. Override when the convention does not apply, e.g. for
// extended_small_factory:  a1=0 a2=1 a3=2 controllable, b1=3 b2=4 b3=5 not:
// #define DES_CONTROLLABLE_MASK 0x07

// ── 3. network: UDP/IP multicast (RFC 1112) ─────────────────────────────────
// Open, brokerless, portable. Every node of the cell joins the same group.
#define DES_MCAST_GROUP "239.192.7.1"
#define DES_MCAST_PORT  5077

// ── 4. experiment knobs ─────────────────────────────────────────────────────
#define DES_ROUNDS            5     // production cycles
#define DES_WORK_MS         250     // simulated machine processing time
#define DES_SIMULATE_LOSS_PCT 0     // try 30 to exercise retransmission,
                                    //     90 to force a SAFE HALT
#define DES_BENCH_LOCKSTEP    0     // 0 = each node walks freely and waits only
                                    //     on SHARED events. Recommended, and
                                    //     required for fms on 2 boards: one
                                    //     node owes 3-4 s per shared apply, so
                                    //     the nodes cannot stay in step.
                                    // 1 = every node replays the whole trace
                                    //     (announces local events too), giving
                                    //     a reproducible global interleaving
                                    //     and the monolithic cross-check.
#define DES_VERIFY_MONO       1     // cross-check against the monolithic supervisor
                                    //   — only with DES_BENCH_LOCKSTEP 1 and a header
                                    //   that has one (fms does not); the summary
                                    //   says when it is off and why.
// Plant-check demonstration: at this step of cycle 1, the owner of the event
// acts as if a sensor had reported it and prints ACCEPTED or REJECTED. Nothing
// is applied. "12" = conveyor C1 finished, before C1 was ever started: the full
// local-modular supervisors reject it, the reduced ones accept it.
// #define DES_INJECT_EVENT   "12"
// #define DES_INJECT_AT_STEP 0

// ── 5. credentials: Wi-Fi and the frame authentication key ──────────────────
// Kept in secrets.h, which is NOT versioned (.gitignore): the Wi-Fi password,
// and the cell's shared key that every frame is signed with. Copy
// secrets.example.h to secrets.h and fill it in; the key must be identical on
// every node of the cell.
#if __has_include("secrets.h")
#  include "secrets.h"
#else
#  error "secrets.h is missing: copy secrets.example.h to secrets.h and fill it in"
#endif

// =============================================================================

#include <Arduino.h>
#include <WiFi.h>
#include <esp_timer.h>

#include "des_generic.h"

static void link_up() {
    Serial.printf("[link] joining '%s'", WIFI_SSID);
    WiFi.mode(WIFI_STA);
    WiFi.begin(WIFI_SSID, WIFI_PASS);
    uint32_t t0 = millis();
    while (WiFi.status() != WL_CONNECTED && millis() - t0 < 30000) {
        delay(400); Serial.print(".");
    }
    if (WiFi.status() != WL_CONNECTED) {
        Serial.println(" FAILED.");
        Serial.println("[link] The nodes need an access point: check WIFI_SSID /");
        Serial.println("       WIFI_PASS in secrets.h.");
        return;
    }
    Serial.printf(" ok — %s\n", WiFi.localIP().toString().c_str());
    // Multicast on a battery-saving station drops frames; keep the radio awake.
    WiFi.setSleep(false);
}

// des_transport.h asks the platform which interface to join the group on.
static uint32_t des_local_ipv4() {
    return (uint32_t)WiFi.localIP();
}

void setup() {
    Serial.begin(115200);
    delay(1500);
    link_up();
    des_setup();
}

void loop() {
    des_loop();

    // By the time loop() runs, the benchmark is over — finished or halted — and
    // USB CDC does not replay output printed before the Serial Monitor was
    // opened. So the summary can be reprinted on request: type anything in the
    // monitor. Said once, not repeated.
    static bool hinted = false;
    if (!hinted) {
        hinted = true;
        Serial.println("[idle] type anything here to reprint the summary; "
                       "RESET every board to run again");
    }
    if (Serial.available()) {
        while (Serial.available()) Serial.read();
        print_summary();
    }
}
