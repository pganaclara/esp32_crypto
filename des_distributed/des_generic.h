// =============================================================================
// des_generic.h — problem-agnostic distributed homomorphic DES supervisor
// =============================================================================
//
// Runs ANY supervisor set generated by the UltraDES notebook, partitioned over
// ANY number of nodes, over ANY transport implementing DesTransport. Nothing in
// this file is specific to a plant, to a board, or to a protocol.
//
// Everything is derived at boot from the generated header:
//   • how many supervisors there are, how big they are, what they constrain;
//   • which supervisor goes on which node;
//   • which events are LOCAL to a node (no traffic) and which are SHARED;
//   • who initiates each event and who must participate in it;
//   • which events are controllable (see DES_CONTROLLABLE_MASK — this is the
//     one property the generated header does not carry).
//
// Verified against every header in this repo:
//   small_factory           4 events,  1 supervisor
//   extended_small_factory  6 events,  2 supervisors
//   fms                    31 events,  7 supervisors (up to 164 states)
//
// ── PORTABILITY ─────────────────────────────────────────────────────────────
// Depends only on mbedTLS, the C++ standard library and a DesTransport. It does
// NOT depend on Arduino, FreeRTOS or ESP-IDF: the four platform touchpoints
// (logging, milliseconds, microseconds, yield) are macros at the top, defaulting
// to Arduino and falling back to POSIX. The same file builds for a Linux
// gateway, an industrial PC or another MCU family.
//
// ── PROTOCOL ────────────────────────────────────────────────────────────────
// Conjunctive fusion over the nodes that constrain an event, with the
// controllable/uncontrollable distinction driving two different mechanisms:
//
//   local event            apply locally                       0 frames
//   shared + controllable  REQ → VOTE* → COMMIT → ACK*         2+2p frames
//   shared + uncontrollab. NOTIFY → ACK*                       1+p  frames
//                                                   (p = number of participants)
//
// An uncontrollable event cannot be vetoed — a supervisor may not disable it,
// and by the time we hear of it the plant has already done it. Asking
// permission would be meaningless; it gets a reliable notification instead.
//
// Concurrency: participants hold a lock between VOTE-YES and COMMIT/ABORT, so
// two initiators can never interleave transactions on the same supervisor. A
// YES is never withdrawn for another request: a locked participant refuses all.
// An initiator still collecting votes yields to an older (lower-numbered)
// requester: WOUND-WAIT (Rosenkrantz et al. 1978). Every request is answered
// at once, so no cycle of waits can form; a refused initiator has applied
// nothing, and retries with backoff.
//
// Loss is handled by retransmission until every participant acknowledges; the
// per-sender sequence number only rejects duplicates. A peer that reboots is
// recognised by its per-boot epoch, and boards built with different settings
// by a configuration fingerprint in every frame. When the budget is exhausted,
// or a peer restarts after shared events, a node SAFE-HALTS rather than
// continue on state that may have diverged. That is the Two Generals trade,
// made explicit: safety preserved, liveness sacrificed.
//
// Plant check: a synthesised supervisor never disables an uncontrollable event
// the plant can produce, so a reported uncontrollable event that ours disable is
// physically impossible — a sensor fault or a forged report — and is rejected
// rather than applied. Only supervisors synthesised over the plant (full local
// modular, monolithic) catch every such event; a reduced one may allow it.
// =============================================================================

#pragma once

#include <stdint.h>
#include <string.h>
#include <stdio.h>
#include <stdlib.h>
#include <vector>

// =============================================================================
// 1. Deployment configuration (override before including this header)
// =============================================================================

#ifndef DES_NODE_ID
#define DES_NODE_ID 1                 // 1 .. DES_NUM_NODES
#endif
#ifndef DES_NUM_NODES
#define DES_NUM_NODES 2
#endif

#ifndef DES_DATA_HEADER
#define DES_DATA_HEADER "supervisor_data_extended_small_factory.h"
#endif

// Which synthesised family to distribute.
#define DES_FAMILY_LMOD     0
#define DES_FAMILY_LMOD_RED 1
#define DES_FAMILY_MONO     2
#ifndef DES_FAMILY
#define DES_FAMILY DES_FAMILY_LMOD_RED
#endif

// The benchmark replays the SIM_SEQ the notebook generated (and validated
// against the supervisors). Reproducible, and directly comparable with the
// single-board sketch. Each node walks its own share and the nodes meet at
// shared events. A step that cannot fire is reported and skipped, never forced.
//
// There is deliberately no free-running driver. One existed — each node fired
// whatever its own supervisors allowed — and it produced traces no plant could:
// a supervisor only forbids what the specification requires, it is not a model
// of the machines (a reduced one even less so), so it happily fired "start
// machine 1" five times in a row. Generating plausible traces needs the plant
// model, which the generated header does not carry.

// How long to wait for one SIM_SEQ step before declaring it inadmissible.
#ifndef DES_STEP_TIMEOUT_MS
#define DES_STEP_TIMEOUT_MS 10000
#endif

#ifndef DES_ROUNDS
#define DES_ROUNDS 5                  // production cycles in the benchmark
#endif
#ifndef DES_WORK_MS
#define DES_WORK_MS 250               // simulated machine processing time
#endif

// ── transaction tuning ──────────────────────────────────────────────────────
// timeout × retries must cover the longest homomorphic step any participant
// can be in when a request arrives: frames keep being RECEIVED during a step
// (he_yield), but they are only ACTED ON when it ends, and one step was
// measured at 3-4 s on `fms`. 1.5 s × 4 tries = 6 s. At 250 ms the initiator
// gave up on commits the peer was about to accept perfectly well.
#ifndef DES_REQ_TIMEOUT_MS
#define DES_REQ_TIMEOUT_MS 1500
#endif
#ifndef DES_ACK_TIMEOUT_MS
#define DES_ACK_TIMEOUT_MS 1500
#endif
#ifndef DES_REQ_RETRIES
#define DES_REQ_RETRIES 4             // failure here is harmless — nothing applied
#endif
#ifndef DES_ACK_RETRIES
#define DES_ACK_RETRIES 5             // failure here forces a SAFE HALT
#endif
#ifndef DES_LOCK_TIMEOUT_MS
#define DES_LOCK_TIMEOUT_MS 2000      // frees a lock held by a dead initiator
#endif
#ifndef DES_RENDEZVOUS_MS
#define DES_RENDEZVOUS_MS 20000
#endif

// Bench-only artificial frame loss (%), applied on receive so the sender still
// counts a transmit and the retransmit path is genuinely exercised.
#ifndef DES_SIMULATE_LOSS_PCT
#define DES_SIMULATE_LOSS_PCT 0
#endif

// Lockstep makes every node walk the WHOLE SIM_SEQ, announcing even its purely
// local events so the others can keep a synchronised replay. It buys a
// reproducible global trace, and it costs a frame per local event plus a
// homomorphic step on every node for an event that concerns only one of them.
//
// It is OFF by default: without it each node walks only its own projection of
// the trace and the nodes meet at shared events, which is all the supervisors
// need. Lockstep makes the slowest node pace every step of every node — on FMS
// one board owes 3-4 s per shared apply — for a global interleaving nothing
// else depends on. Turn it on for small problems where one reproducible
// interleaving matters more than throughput.
#ifndef DES_BENCH_LOCKSTEP
#define DES_BENCH_LOCKSTEP 0
#endif

// Cross-check every decision against the MONOLITHIC supervisor from the same
// header. Only possible with DES_BENCH_LOCKSTEP 1 (a node must see every event
// to replay the trace) and a header that has one; the summary says when it is
// off and why.
#ifndef DES_VERIFY_MONO
#define DES_VERIFY_MONO 1
#endif

// Plant-check demonstration. At step DES_INJECT_AT_STEP of cycle 1, the owner of
// event DES_INJECT_EVENT acts as if a sensor had just reported it and prints
// whether the plant check would accept it. Nothing is applied, so the run is
// otherwise unchanged. Off unless DES_INJECT_EVENT is defined, e.g.
//   #define DES_INJECT_EVENT   "12"   // "conveyor C1 finished"...
//   #define DES_INJECT_AT_STEP 0      // ...before C1 was ever started
#ifndef DES_INJECT_AT_STEP
#define DES_INJECT_AT_STEP 0
#endif

// =============================================================================
// 2. Platform abstraction — the only four touchpoints
// =============================================================================

#if defined(ARDUINO)
#  include <Arduino.h>
#  if defined(ESP_PLATFORM) || defined(ARDUINO_ARCH_ESP32)
#    include <esp_timer.h>
#  endif
#  ifndef DES_LOG
#    define DES_LOG(...) Serial.printf(__VA_ARGS__)
#  endif
#  define DES_YIELD()    yield()
#else
#  include <time.h>
#  include <sched.h>
#  ifndef DES_LOG
#    define DES_LOG(...) printf(__VA_ARGS__)
#  endif
#  define DES_YIELD()    sched_yield()
   // The generated headers are written for the Arduino flash-string macros.
   // On a hosted platform they are plain memory.
#  ifndef PROGMEM
#    define PROGMEM
#  endif
#  ifndef pgm_read_byte
#    define pgm_read_byte(a) (*(const uint8_t*)(a))
#  endif
#  ifndef pgm_read_word
#    define pgm_read_word(a) (*(const uint16_t*)(a))
#  endif
#  ifndef pgm_read_ptr
#    define pgm_read_ptr(a)  (*(void* const*)(a))
#  endif
#  ifndef strncpy_P
#    define strncpy_P strncpy
#  endif
#endif

static uint32_t des_millis() {
#if defined(ARDUINO)
    return (uint32_t)millis();
#else
    struct timespec ts; clock_gettime(CLOCK_MONOTONIC, &ts);
    return (uint32_t)(ts.tv_sec * 1000ULL + ts.tv_nsec / 1000000ULL);
#endif
}
static uint64_t des_micros() {
#if defined(ARDUINO)
    return (uint64_t)esp_timer_get_time();
#else
    struct timespec ts; clock_gettime(CLOCK_MONOTONIC, &ts);
    return (uint64_t)ts.tv_sec * 1000000ULL + ts.tv_nsec / 1000ULL;
#endif
}
static void des_sleep_ms(uint32_t ms) {
#if defined(ARDUINO)
    delay(ms);
#else
    struct timespec ts; ts.tv_sec = ms / 1000; ts.tv_nsec = (long)(ms % 1000) * 1000000L;
    nanosleep(&ts, nullptr);
#endif
}

#include <mbedtls/ecp.h>
#include <mbedtls/bignum.h>
#include <mbedtls/entropy.h>
#include <mbedtls/ctr_drbg.h>
#include <mbedtls/md.h>
#include <stddef.h>

#include DES_DATA_HEADER
#include "des_transport.h"

// =============================================================================
// 3. Family selection — resolves to a descriptor array + count
// =============================================================================

#if DES_FAMILY == DES_FAMILY_LMOD
#  define DES_SUPS   LMOD_SUPS
#  define DES_NSUPS  LMOD_COUNT
#  define DES_FAMILY_NAME "LOCAL MODULAR"
#elif DES_FAMILY == DES_FAMILY_LMOD_RED
#  define DES_SUPS   LMOD_RED_SUPS
#  define DES_NSUPS  LMOD_RED_COUNT
#  define DES_FAMILY_NAME "LOCAL MODULAR REDUCED"
#else
#  if !HAS_MONO
#    error "DES_FAMILY_MONO selected but this header has no monolithic supervisor"
#  endif
#  define DES_SUPS   (&MONO_SUP)
#  define DES_NSUPS  1
#  define DES_FAMILY_NAME "MONOLITHIC"
#endif

// Whether the supervisors carry the plant. The full local-modular and the
// monolithic supervisors are synthesised over the plant, so their state tracks
// the machines: an uncontrollable event they disable is one no machine could
// produce from here. Reduction merges states that differ only in behaviour the
// plant cannot generate, so a reduced supervisor may allow such an event — it
// relies on the plant never producing it.
#if DES_FAMILY == DES_FAMILY_LMOD_RED
#  define DES_FAMILY_HAS_PLANT 0
#else
#  define DES_FAMILY_HAS_PLANT 1
#endif

static_assert(DES_NODE_ID >= 1 && DES_NODE_ID <= DES_NUM_NODES,
              "DES_NODE_ID must be in 1..DES_NUM_NODES");
static_assert(DES_NUM_NODES >= 1 && DES_NUM_NODES <= 31,
              "node masks are 32-bit");
static_assert(EVENT_COUNT <= 32, "event masks are 32-bit");

// =============================================================================
// 4. Crypto configuration
// =============================================================================

#ifndef DES_CURVE
#define DES_CURVE      MBEDTLS_ECP_DP_SECP192R1
#define DES_CURVE_NAME "secp192r1"
#define DES_PT_LEN     25                     // 1 prefix + 24-byte X coord
#endif

struct Ciphertext { uint8_t c1[DES_PT_LEN]; uint8_t c2[DES_PT_LEN]; };

struct Supervisor {
    const SupDesc* desc;
    int            global_index = -1;
    uint32_t       trans_event_mask = 0;
    std::vector<uint8_t>              constrained_gi;
    std::vector<Ciphertext>           enc;
    std::vector<mbedtls_ecp_point>    dec_c1, dec_c2;
    std::vector<int8_t>               cached_en;
    std::vector<std::vector<uint8_t>> changes_if_zero;
    std::vector<std::vector<uint8_t>> changes_if_one;
};

// =============================================================================
// 5. Wire format
// =============================================================================

#define DES_MAGIC 0xD3510C01u

// Bumped whenever the wire format or its meaning changes; part of the config
// fingerprint, so boards flashed from different versions refuse each other.
#define DES_PROTO_VERSION 6

enum : uint8_t {
    M_HELLO = 1, M_REQ, M_VOTE, M_COMMIT, M_NOTIFY,
    M_ACK, M_ABORT, M_ANNOUNCE, M_HALT, M_PING, M_PONG, M_SKIP,
    // "My driver has reached occurrence `occ` of shared event `ev` and is
    // waiting for it." The plant half of a synchronous product: see
    // await_participants().
    M_AT,
    // Epoch challenge and its answer (see "Frame authentication" below).
    // `vote` carries the node addressed; `seq` and `occ` the 64-bit nonce.
    M_CHAL, M_RESP,
    M_TYPE_LAST = M_RESP
};

// Bytes of HMAC-SHA256 kept as the frame's tag. RFC 2104 §5 recommends not
// truncating below half the hash output (and never below 80 bits).
#define DES_TAG_BYTES 16

struct __attribute__((packed)) DesFrame {
    uint32_t magic;
    uint8_t  type;
    uint8_t  src;      // originating node id
    uint8_t  ev;       // global event index
    uint8_t  vote;     // M_VOTE only
    uint32_t seq;      // per-sender sequence number
    // Which occurrence of `ev` in the scripted trace this frame is about: the
    // third time `31` appears in SIM_SEQ across all cycles is occurrence 3.
    // Every node walks the same trace, so every node computes the same number,
    // and "has occurrence k been resolved?" becomes a question with a yes/no
    // answer instead of a counter to watch for an increment. 0 in frames that
    // are not about a step of the trace.
    uint32_t occ;
    // Random per boot. Tells a peer's reboot apart from its retransmission —
    // a rebooted owner restarts its sequence at 1, which a participant would
    // otherwise read as a duplicate, acknowledge, and silently not apply —
    // and tells a second board wrongly flashed with our own id apart from
    // our own echo. A new epoch is only believed once its owner has answered
    // a fresh challenge (see "Frame authentication").
    uint32_t epoch;
    // Fingerprint of everything two nodes must agree on: protocol version,
    // node count, lockstep, family, event table, partition, trace. Two boards
    // built from different headers or settings derive different routing
    // tables and would otherwise talk past each other without an error.
    uint32_t cfg;
    // Per-sender frame counter, strictly increasing within an epoch. Every
    // frame gets a new one — a retransmission included — so a receiver can
    // drop anything it has already seen: the defence against replay within a
    // boot.
    uint32_t ctr;
    // HMAC-SHA256 over every byte above, under the cell's shared key,
    // truncated to DES_TAG_BYTES.
    uint8_t  tag[DES_TAG_BYTES];
};
static_assert(sizeof(DesFrame) == DES_FRAME_BYTES, "frame size mismatch");

// =============================================================================
// 6. Globals
// =============================================================================

static std::vector<Supervisor>  g_sups;          // MY supervisors only
static mbedtls_ecp_group        g_grp;
static mbedtls_ecp_point        g_G, g_pub;
static mbedtls_mpi              g_priv, g_one, g_neg_priv;
static mbedtls_ctr_drbg_context g_drbg;
static mbedtls_entropy_context  g_entropy;
static Ciphertext               g_zero;

// Per-event routing, derived at boot from EVERY supervisor descriptor.
struct EvRoute {
    uint32_t node_mask;      // bit (n-1) set if node n holds a relevant supervisor
    uint32_t part_mask;      // node_mask without the owner
    uint8_t  owner;
    bool     shared;
    bool     controllable;
};
static EvRoute g_route[EVENT_COUNT];
static uint32_t g_my_node_bit = 1u << (DES_NODE_ID - 1);

static uint32_t g_my_seq  = 0;                       // my outgoing COMMIT/NOTIFY seq
#if DES_BENCH_LOCKSTEP
static uint32_t g_ann_seq = 0;                       // my outgoing ANNOUNCE seq
#endif
static uint32_t g_seq_from[DES_NUM_NODES + 2];       // last commit applied, per sender
static uint32_t g_ann_from[DES_NUM_NODES + 2];       // last announce seen, per sender
// Highest occurrence of each event that its owner has RESOLVED — applied or
// skipped — as far as this node knows. Monotone: the owner walks the trace in
// order, so resolving occurrence k implies every earlier one is resolved too,
// which also makes a lost frame harmless once a later one arrives.
static uint32_t g_resolved_occ[EVENT_COUNT];
// Highest occurrence of each event that each peer's driver has reached.
static uint32_t g_at_occ[DES_NUM_NODES + 2][EVENT_COUNT];
static uint32_t g_skips = 0;                         // inadmissible SIM_SEQ steps
static uint32_t g_impossible = 0;                    // reports rejected by the plant check
static uint32_t g_peer_seen = 0;                     // bitmask of nodes heard from

static uint32_t g_epoch = 0;                         // mine, random per boot
static uint32_t g_epoch_from[DES_NUM_NODES + 2];     // each peer's CONFIRMED epoch
static uint32_t g_cfg = 0;                           // config fingerprint
static uint32_t g_cfg_bad_from = 0;                  // peers with another config
static bool     g_dup_id = false;                    // another board claims my id

// =============================================================================
// 6a. Frame authentication
// =============================================================================
//
// Without this, anyone on the plant network could stop the cell with one
// datagram (M_HALT), drive a shared event (a forged COMMIT), or read nothing
// less than the timing of every shared event. The configuration fingerprint
// is no defence: it is computed from the header, which is not secret.
//
// Three layers, the same three OPC UA PubSub uses in its Sign mode (IEC
// 62541-14: a signature, a sequence number, keys scoped to a security group):
//
//   1. INTEGRITY + AUTHENTICITY. Every frame carries HMAC-SHA256 over all its
//      other bytes, keyed with the cell's shared secret DES_AUTH_KEY, truncated
//      to 128 bits. A frame whose tag does not verify is dropped before a
//      single field of it is read. The ESP32's SHA peripheral computes it.
//
//   2. FRESHNESS WITHIN A BOOT. Every frame carries a per-sender counter that
//      only increases. A receiver drops any frame whose counter it has already
//      passed — a recorded frame replayed during the same run is rejected.
//
//   3. FRESHNESS ACROSS BOOTS. A counter cannot order two different boots, and
//      a recording from yesterday's run carries yesterday's epoch — which, if
//      simply believed, looks exactly like "the peer rebooted" and halts the
//      cell. So a new epoch is never believed on sight. The receiver sends a
//      random 64-bit nonce (M_CHAL) and accepts the epoch only when an M_RESP
//      carrying that nonce and that epoch comes back, correctly tagged. A
//      recording cannot answer a question that did not exist when it was made.
//      Until then the stranger's frames are dropped; the protocol retransmits
//      whatever mattered.
//
// What this does NOT give: confidentiality. Frames are signed, not encrypted —
// an observer still sees which shared events happen and how nodes vote (OPC UA
// calls the stronger mode SignAndEncrypt). And the key is pre-shared by hand;
// in OPC UA a Security Key Service distributes and rotates it.
#ifndef DES_AUTH_KEY
#  error "Set DES_AUTH_KEY — the cell's shared secret, the same on every node (see secrets.example.h)"
#endif
static_assert(sizeof(DES_AUTH_KEY) - 1 >= 32,
              "DES_AUTH_KEY must be at least 32 characters — use a random one");

static uint32_t g_ctr_tx = 0;                        // my frame counter
static uint32_t g_ctr_from[DES_NUM_NODES + 2];       // highest accepted, per sender
static uint32_t g_chal_lo[DES_NUM_NODES + 2], g_chal_hi[DES_NUM_NODES + 2];
static bool     g_chal_pending[DES_NUM_NODES + 2];
static uint32_t g_chal_t[DES_NUM_NODES + 2];
static uint32_t g_auth_bad = 0, g_auth_bad_from = 0; // tags that did not verify
static uint32_t g_replays = 0;                       // counter already passed
static uint32_t g_challenges = 0;
static double   g_mac_us = 0;                        // measured at boot

static void des_mac(const DesFrame& f, uint8_t out[DES_TAG_BYTES]) {
    uint8_t full[32];
    mbedtls_md_hmac(mbedtls_md_info_from_type(MBEDTLS_MD_SHA256),
                    (const unsigned char*)DES_AUTH_KEY, sizeof(DES_AUTH_KEY) - 1,
                    (const unsigned char*)&f, offsetof(DesFrame, tag), full);
    memcpy(out, full, DES_TAG_BYTES);
}
// Constant-time: how much of a forged tag was right must not show in timing.
static bool des_mac_ok(const DesFrame& f) {
    uint8_t t[DES_TAG_BYTES];
    des_mac(f, t);
    uint8_t d = 0;
    for (int i = 0; i < DES_TAG_BYTES; ++i) d |= (uint8_t)(t[i] ^ f.tag[i]);
    return d == 0;
}

static bool        g_safe_halt = false;
static const char* g_halt_why  = nullptr;

// Participant lock (held between VOTE-YES and COMMIT/ABORT).
static uint8_t  g_lock_by = 0;
static uint32_t g_lock_t0 = 0;

// The initiator's side of the same discipline. While this node is collecting
// votes for its own transaction (phase 1) or committing it (phase 2), its state
// is spoken for exactly as a participant's is: voting YES on someone else's
// request and then committing its own would apply two events that were each
// judged against a state the other one changes. Wound-wait decides who yields.
static uint8_t  g_init_phase = 0;         // 0 idle, 1 collecting votes, 2 committing
static bool     g_wounded    = false;     // an older transaction preempted mine

// A peer holds this node's lock. Expired locks — an initiator that died between
// REQ and COMMIT — are released here, so the check is also the cleanup.
static bool lock_held() {
    if (g_lock_by && des_millis() - g_lock_t0 > DES_LOCK_TIMEOUT_MS) g_lock_by = 0;
    return g_lock_by != 0;
}

// The one reply the initiator is currently blocked on (see collect()).
static uint8_t  g_await_type = 0;
static uint32_t g_await_seq  = 0, g_await_need = 0, g_await_got = 0;
static bool     g_await_no   = false;

static uint32_t g_tx = 0, g_rx = 0, g_retx = 0;
static int      g_step_decrypts = 0;

struct Acc {
    uint32_t n = 0;
    uint64_t he = 0, net = 0, wall = 0, wmin = UINT64_MAX, wmax = 0;
    void add(uint64_t h, uint64_t t, uint64_t w) {
        ++n; he += h; net += t; wall += w;
        if (w < wmin) wmin = w;
        if (w > wmax) wmax = w;
    }
};
static Acc g_acc_local, g_acc_ctrl, g_acc_unctrl;
static Acc g_acc_part;                  // shared events applied FOR a peer
static uint64_t g_sync_us = 0;          // owner waiting for peers to reach a step
static uint32_t g_sync_n  = 0;

// =============================================================================
// 6b. Deferred receive queue — why a node must never stop reading the socket
// =============================================================================
//
// A homomorphic step is not fast. On an ESP32-S3 one scalar multiplication on
// secp192r1 costs ~69 ms, and a step owes one per DISTINCT row sum it must
// re-evaluate (row_decrypt sums the row first, then does a single blinded
// multiplication; see he_step). Before rows were shared this was measured at
// 32-47 multiplications, 3-4 s, for one `fms` event on the node holding S4-S6.
//
// lwIP's UDP receive mailbox holds CONFIG_LWIP_UDP_RECVMBOX_SIZE datagrams —
// 6 by default, and an Arduino build links precompiled ESP-IDF libraries and
// cannot change it, so 6 is what runs. A node that does not call recvfrom() for 3 s therefore drops
// everything after the sixth frame its peers sent in that window. Silently:
// UDP has no flow control and the sender learns nothing.
//
// The fix is to keep draining the socket while computing. Draining is not
// the same as acting on what arrives: M_COMMIT calls he_step(), so handling a
// frame from inside he_step() would re-enter it and mutate `g_sups` under the
// outer call's own references — and answering M_REQ mid-step would vote on a
// `cached_en` array that is neither the pre-event nor the post-event state.
//
// So reading and dispatching are split. he_yield() only moves datagrams from
// the kernel into this queue, touching no supervisor state and sending
// nothing; pump() dispatches, and refuses to while a step is in flight. The
// queue is the buffer lwIP will not give us.
#ifndef DES_RXQ_LEN
#define DES_RXQ_LEN 64
#endif
static DesFrame g_rxq[DES_RXQ_LEN];
static uint16_t g_rxq_head = 0, g_rxq_tail = 0;
static uint32_t g_rxq_drops = 0;        // queue full — the one loss we can see
static uint16_t g_rxq_peak  = 0;        // high-water mark, for the summary
static bool     g_in_he     = false;    // a homomorphic step is in flight

// ── log framing ──────────────────────────────────────────────────────────────
// Two kinds of line come out of a running node, and mixing them is what makes
// a distributed log unreadable. DRIVER lines are this node walking the trace,
// in order, one per step. REACTIVE lines are this node answering a peer — a
// vote, an applied commit — and they land whenever the peer happens to ask,
// interleaved with the driver's own walk.
//
// So the step counter is printed on driver lines and a dot on reactive ones.
// Anything in the dot column is something a peer caused; anything with a step
// number is where this node is in SIM_SEQ.
static int g_cycle = 0, g_step = -1;

// Run clock. Each node prints the end of every cycle on it, so the time the
// nodes take together for a cycle is the LATEST of their prints. Node 1 starts
// it when its round-trip probe ends and its run begins; the others restart it
// on every probe PING, so their clocks start within about one round trip of
// node 1's instead of while node 1 is still probing.
static uint64_t g_run_t0 = 0;
static double   g_cycle_end_ms[DES_ROUNDS];
static int      g_cycles_done = 0;

#define DES_STEP_TAG()  DES_LOG("c%-2d s%-3d ", g_cycle, g_step)
#define DES_REACT_TAG() DES_LOG("    ·     ")

static inline uint16_t rxq_count() {
    return (uint16_t)((g_rxq_head - g_rxq_tail) & (uint16_t)(DES_RXQ_LEN - 1));
}
static_assert((DES_RXQ_LEN & (DES_RXQ_LEN - 1)) == 0, "DES_RXQ_LEN must be a power of two");

// Move every waiting datagram out of the kernel and into our own queue.
// Safe to call from anywhere, including deep inside a homomorphic step: it
// reads no supervisor state, writes none, and transmits nothing.
//
// It is also the only door into the node, so everything that arrives is
// checked here before any of it can index a table. A multicast group is open
// to anything on the segment; `ev` indexes g_route and every supervisor's
// per-event vectors, and an out-of-range one would write past them.
static void he_yield() {
    DES_TRANSPORT_IMPL.service();
    DesFrame f;
    while (DES_TRANSPORT_IMPL.poll(&f, sizeof(f))) {
        if (f.magic != DES_MAGIC)                   continue;
        // The tag is checked before ANY other field is believed: until it
        // verifies, `src`, `type` and the rest are whatever a stranger wrote.
        if (!des_mac_ok(f)) {
            ++g_auth_bad;
            // One report per claimed sender; bit 31 (never a node: at most 31)
            // stands for "no valid sender at all".
            uint32_t bit = (f.src >= 1 && f.src <= DES_NUM_NODES) ? 1u << (f.src - 1)
                                                                  : 0x80000000u;
            if (!(g_auth_bad_from & bit)) {
                g_auth_bad_from |= bit;
                DES_LOG("\n[!!] frame claiming node %d FAILED AUTHENTICATION — "
                        "forged, corrupted, or built with a different "
                        "DES_AUTH_KEY; dropped\n\n", (int)f.src);
            }
            continue;
        }
        if (f.type < M_HELLO || f.type > M_TYPE_LAST) continue;
        if (f.src == 0 || f.src > DES_NUM_NODES)    continue;
        if (f.ev >= EVENT_COUNT && f.type != M_HALT) continue;
        // Our own echo carries our epoch. A validly tagged frame claiming our
        // id with ANOTHER epoch is either a second board flashed with the same
        // DES_NODE_ID or a recording of one of our earlier boots; dispatch()
        // tells them apart with a challenge (see check_duplicate_id).
        if (f.src == DES_NODE_ID && f.epoch == g_epoch) continue;
        if (f.cfg != g_cfg) {
            uint32_t bit = 1u << (f.src - 1);
            if (!(g_cfg_bad_from & bit)) {
                g_cfg_bad_from |= bit;
                DES_LOG("\n[!!] node %d runs a DIFFERENT configuration (header, "
                        "family, partition, lockstep or firmware version differ) — "
                        "ignoring it. Flash every board from the same settings, "
                        "changing only DES_NODE_ID.\n\n", (int)f.src);
            }
            continue;
        }
        // A node flagged earlier that now matches has been reflashed or has
        // restarted with the right settings. It is accepted from here on, so
        // the summary must not keep reporting it as ignored.
        if (g_cfg_bad_from & (1u << (f.src - 1))) {
            g_cfg_bad_from &= ~(1u << (f.src - 1));
            DES_LOG("[net] node %d now runs the same configuration — accepted\n",
                    (int)f.src);
        }
#if DES_SIMULATE_LOSS_PCT > 0
        if ((int)(rand() % 100) < DES_SIMULATE_LOSS_PCT) continue;
#endif
        ++g_rx;
        if (rxq_count() == DES_RXQ_LEN - 1) { ++g_rxq_drops; continue; }
        g_rxq[g_rxq_head] = f;
        g_rxq_head = (uint16_t)((g_rxq_head + 1) & (DES_RXQ_LEN - 1));
        if (rxq_count() > g_rxq_peak) g_rxq_peak = rxq_count();
    }
}

// =============================================================================
// 7. PROGMEM helpers
// =============================================================================

static inline int8_t   pm_i8 (const int8_t*   a, int i) { return (int8_t) pgm_read_byte(a+i); }
static inline int16_t  pm_i16(const int16_t*  a, int i) { return (int16_t)pgm_read_word(a+i); }
static inline uint16_t pm_u16(const uint16_t* a, int i) { return (uint16_t)pgm_read_word(a+i); }

static inline bool is_g_zero(const Ciphertext& c) {
    return memcmp(&c, &g_zero, sizeof(Ciphertext)) == 0;
}
static int trans_offset(const SupDesc* d, int ev) {
    int off = 0; for (int i = 0; i < ev; ++i) off += (int)pm_u16(d->tcnt, i); return off;
}
static inline void swap_pt(mbedtls_ecp_point* a, mbedtls_ecp_point* b) {
    mbedtls_ecp_point t = *a; *a = *b; *b = t;
}
static void sv_free_dec(Supervisor& sv) {
    for (auto& p : sv.dec_c1) mbedtls_ecp_point_free(&p);
    for (auto& p : sv.dec_c2) mbedtls_ecp_point_free(&p);
    sv.dec_c1.clear(); sv.dec_c2.clear();
}
static const char* ev_name(int gi, char* buf) {
    strncpy_P(buf, (const char*)pgm_read_ptr(&EVENT_NAMES[gi]), 15);
    buf[15] = 0; return buf;
}
static const char* sup_name(const SupDesc* d, char* buf) {
    strncpy_P(buf, (const char*)pgm_read_ptr(&d->name), 15);
    buf[15] = 0; return buf;
}

// =============================================================================
// 8. EC-ElGamal
// =============================================================================

static int pt_compress(const mbedtls_ecp_point* P, uint8_t out[DES_PT_LEN]) {
    size_t len = 0;
    return mbedtls_ecp_point_write_binary(&g_grp, P, MBEDTLS_ECP_PF_COMPRESSED,
                                          &len, out, DES_PT_LEN);
}
static int pt_decompress(const uint8_t in[DES_PT_LEN], mbedtls_ecp_point* P) {
    mbedtls_ecp_point_init(P);
    return mbedtls_ecp_point_read_binary(&g_grp, P, in, DES_PT_LEN);
}
static int pt_add(mbedtls_ecp_point* R, const mbedtls_ecp_point* P,
                  const mbedtls_ecp_point* Q) {
    return mbedtls_ecp_muladd(&g_grp, R, &g_one, P, &g_one, Q);
}

static int elgamal_enc(int m, Ciphertext* ct, mbedtls_ctr_drbg_context* drbg) {
    mbedtls_mpi r; mbedtls_mpi_init(&r);
    mbedtls_ecp_point rP, c1, c2;
    mbedtls_ecp_point_init(&rP); mbedtls_ecp_point_init(&c1); mbedtls_ecp_point_init(&c2);
    int ret = mbedtls_ecp_gen_privkey(&g_grp, &r, mbedtls_ctr_drbg_random, drbg); if (ret) goto done;
    ret = mbedtls_ecp_mul(&g_grp, &c1, &r, &g_G,   mbedtls_ctr_drbg_random, drbg); if (ret) goto done;
    ret = mbedtls_ecp_mul(&g_grp, &rP, &r, &g_pub, mbedtls_ctr_drbg_random, drbg); if (ret) goto done;
    if (m == 0) {
        mbedtls_ecp_copy(&c2, &rP);
    } else {
        mbedtls_ecp_point mG; mbedtls_mpi mm;
        mbedtls_ecp_point_init(&mG); mbedtls_mpi_init(&mm);
        mbedtls_mpi_lset(&mm, m);
        ret = mbedtls_ecp_mul(&g_grp, &mG, &mm, &g_G, mbedtls_ctr_drbg_random, drbg);
        if (ret == 0) ret = pt_add(&c2, &mG, &rP);
        mbedtls_ecp_point_free(&mG); mbedtls_mpi_free(&mm);
    }
    if (ret) goto done;
    ret = pt_compress(&c1, ct->c1);
    if (ret == 0) ret = pt_compress(&c2, ct->c2);
done:
    mbedtls_ecp_point_free(&rP); mbedtls_ecp_point_free(&c1); mbedtls_ecp_point_free(&c2);
    mbedtls_mpi_free(&r);
    return ret;
}

static int elgamal_dec(const Ciphertext* ct, int* out) {
    mbedtls_ecp_point c1, c2, pm;
    mbedtls_ecp_point_init(&c1); mbedtls_ecp_point_init(&c2); mbedtls_ecp_point_init(&pm);
    int ret = pt_decompress(ct->c1, &c1); if (ret) goto done;
    ret     = pt_decompress(ct->c2, &c2); if (ret) goto done;
    ret = mbedtls_ecp_muladd(&g_grp, &pm, &g_neg_priv, &c1, &g_one, &c2);
    if (ret == 0) *out = mbedtls_ecp_is_zero(&pm) ? 0 : 1;
done:
    mbedtls_ecp_point_free(&c1); mbedtls_ecp_point_free(&c2); mbedtls_ecp_point_free(&pm);
    return ret;
}

static int elgamal_add(const Ciphertext* a, const Ciphertext* b, Ciphertext* out) {
    mbedtls_ecp_point pa1, pa2, pb1, pb2, r1, r2;
    mbedtls_ecp_point_init(&pa1); mbedtls_ecp_point_init(&pa2);
    mbedtls_ecp_point_init(&pb1); mbedtls_ecp_point_init(&pb2);
    mbedtls_ecp_point_init(&r1);  mbedtls_ecp_point_init(&r2);
    int ret = pt_decompress(a->c1, &pa1); if (ret) goto done;
    ret     = pt_decompress(a->c2, &pa2); if (ret) goto done;
    ret     = pt_decompress(b->c1, &pb1); if (ret) goto done;
    ret     = pt_decompress(b->c2, &pb2); if (ret) goto done;
    ret = pt_add(&r1, &pa1, &pb1); if (ret) goto done;
    ret = pt_add(&r2, &pa2, &pb2); if (ret) goto done;
    ret = pt_compress(&r1, out->c1);
    if (ret == 0) ret = pt_compress(&r2, out->c2);
done:
    mbedtls_ecp_point_free(&pa1); mbedtls_ecp_point_free(&pa2);
    mbedtls_ecp_point_free(&pb1); mbedtls_ecp_point_free(&pb2);
    mbedtls_ecp_point_free(&r1);  mbedtls_ecp_point_free(&r2);
    return ret;
}

// Fused homomorphic row-sum + blinded decrypt.
static int row_decrypt(const Supervisor& sv, const int8_t* row, int n,
                       int* out, bool* did) {
    *did = false;
    int first = -1;
    for (int i = 0; i < n; ++i) {
        if (!pm_i8(row, i))       continue;
        if (is_g_zero(sv.enc[i])) continue;
        first = i; break;
    }
    if (first < 0) { *out = 0; return 0; }

    mbedtls_ecp_point s1, s2, tmp;
    mbedtls_ecp_point_init(&s1); mbedtls_ecp_point_init(&s2); mbedtls_ecp_point_init(&tmp);
    int ret = mbedtls_ecp_copy(&s1, &sv.dec_c1[first]); if (ret) goto done;
    ret     = mbedtls_ecp_copy(&s2, &sv.dec_c2[first]); if (ret) goto done;
    for (int i = first + 1; i < n; ++i) {
        if (!pm_i8(row, i))       continue;
        if (is_g_zero(sv.enc[i])) continue;
        ret = mbedtls_ecp_muladd(&g_grp, &tmp, &g_one, &s1, &g_one, &sv.dec_c1[i]); if (ret) goto done;
        swap_pt(&s1, &tmp);
        ret = mbedtls_ecp_muladd(&g_grp, &tmp, &g_one, &s2, &g_one, &sv.dec_c2[i]); if (ret) goto done;
        swap_pt(&s2, &tmp);
    }
    {   // The scalar multiplication below is the single most expensive thing
        // this firmware does (~69 ms on an ESP32-S3). Clear the socket first so
        // the kernel's 6-datagram mailbox is empty going into it.
        he_yield();
        // Scalar blinding: the DRBG callback keeps the scalar mul's timing and
        // power profile from leaking bits of the private key.
        mbedtls_ecp_point ns, pm;
        mbedtls_ecp_point_init(&ns); mbedtls_ecp_point_init(&pm);
        ret = mbedtls_ecp_mul(&g_grp, &ns, &g_neg_priv, &s1, mbedtls_ctr_drbg_random, &g_drbg);
        if (ret == 0) ret = mbedtls_ecp_muladd(&g_grp, &pm, &g_one, &s2, &g_one, &ns);
        if (ret == 0) { *out = mbedtls_ecp_is_zero(&pm) ? 0 : 1; *did = true; }
        mbedtls_ecp_point_free(&ns); mbedtls_ecp_point_free(&pm);
    }
done:
    mbedtls_ecp_point_free(&s1); mbedtls_ecp_point_free(&s2); mbedtls_ecp_point_free(&tmp);
    return ret;
}

static void do_transition(Supervisor& sv, int ev, int n) {
    int      off = trans_offset(sv.desc, ev);
    uint16_t pc  = pm_u16(sv.desc->tcnt, ev);
    std::vector<Ciphertext>        nxt(n, g_zero);
    std::vector<mbedtls_ecp_point> n1(n), n2(n);
    for (int i = 0; i < n; ++i) { mbedtls_ecp_point_init(&n1[i]); mbedtls_ecp_point_init(&n2[i]); }
    // The image of a state set under an event is a UNION, not an assignment.
    // Several source states may converge on the same target (fms has 11 such
    // collisions in its reduced supervisors), and writing `nxt[t] = enc[f]`
    // unconditionally lets whichever pair happens to come last win — so an
    // INACTIVE source silently overwrites an ACTIVE one, and the result depends
    // on the order the generator happened to emit the pairs in.
    //
    // Skipping zero sources makes the common path both correct and unchanged in
    // cost: a cell holding the literal Enc(0) contributes nothing to a union, so
    // it can never clobber an active cell. If two ACTIVE sources ever converge
    // (impossible for a one-hot state, but not something to assume), they are
    // combined with the additive homomorphism, which is exactly the OR this
    // encoding uses everywhere else.
    for (uint16_t p = 0; p < pc; ++p) {
        int f = pm_i16(sv.desc->trans + off*2, p*2);
        int t = pm_i16(sv.desc->trans + off*2, p*2+1);
        if (is_g_zero(sv.enc[f])) continue;              // contributes nothing
        if (is_g_zero(nxt[t])) {
            nxt[t] = sv.enc[f];
            mbedtls_ecp_copy(&n1[t], &sv.dec_c1[f]);
            mbedtls_ecp_copy(&n2[t], &sv.dec_c2[f]);
        } else {
            mbedtls_ecp_point s1, s2;
            mbedtls_ecp_point_init(&s1); mbedtls_ecp_point_init(&s2);
            if (pt_add(&s1, &n1[t], &sv.dec_c1[f]) == 0 &&
                pt_add(&s2, &n2[t], &sv.dec_c2[f]) == 0) {
                mbedtls_ecp_copy(&n1[t], &s1);
                mbedtls_ecp_copy(&n2[t], &s2);
                pt_compress(&n1[t], nxt[t].c1);
                pt_compress(&n2[t], nxt[t].c2);
            }
            mbedtls_ecp_point_free(&s1); mbedtls_ecp_point_free(&s2);
        }
    }
    sv_free_dec(sv);
    sv.enc = std::move(nxt); sv.dec_c1 = std::move(n1); sv.dec_c2 = std::move(n2);
}

// Apply an event to every local supervisor that transitions on it, refreshing
// the enablement bits that could have flipped. Returns microseconds spent.
static uint64_t he_step(int ev) {
    uint64_t t0 = des_micros();
    g_step_decrypts = 0;
    // Hold off frame DISPATCH for the duration — a COMMIT handled here would
    // re-enter this function and mutate `g_sups` under our own references, and
    // an M_REQ would be answered from a half-updated `cached_en`. Reading the
    // socket continues throughout (he_yield below); only acting on it waits.
    g_in_he = true;
    static std::vector<uint8_t>  queued;   // rows whose cached bit could flip
    static std::vector<uint8_t>  unit_of;  // queued[k] -> index into reps
    static std::vector<uint8_t>  reps;     // one representative row per distinct sum
    static std::vector<int8_t>   outs;
    static std::vector<uint16_t> nz;       // cells that are not the g_zero literal
    for (auto& sv : g_sups) {
        if (!(sv.trans_event_mask & (1u << ev))) continue;
        int n = (int)pgm_read_word(&sv.desc->num_states);
        he_yield();
        do_transition(sv, ev, n);

        // (1) The work list is built from the cached bits as they stood BEFORE
        // this step, and nothing is decrypted until it is complete. A row can
        // sit in both flip lists; decrypting as the lists were walked let the
        // first pass flip it 0->1, after which the second pass saw a 1 and
        // decrypted the very same row again. Same answer, a wasted 69 ms scalar
        // multiplication — measured on two ESP32-S3 as exactly twice the
        // necessary work on node 1 (420 decryptions where 210 were needed).
        // The single-board sketch was corrected long ago; this is the same fix.
        queued.clear();
        for (uint8_t li : sv.changes_if_zero[ev]) if (sv.cached_en[li] == 0) queued.push_back(li);
        for (uint8_t li : sv.changes_if_one[ev])  if (sv.cached_en[li] == 1) queued.push_back(li);
        if (queued.empty()) continue;

        // (2) OPTIMISATION 6 — share identical row sums, as in the single-board
        // sketch. row_decrypt sums the cells of a row that are not the literal
        // g_zero, so a row's homomorphic sum is fixed by WHICH NON-ZERO CELLS
        // it covers, not by the row itself. Once the non-zero set has
        // contracted to the active cell, every row covering that cell has the
        // same sum; decrypt each distinct sum once and fan the bit out. Nothing
        // new is revealed: this reuses a value the code already computes, via
        // the is_g_zero test row_decrypt already performs. Predicted from the
        // hardware log with a ciphertext-level model that reproduces every
        // decryption count in it: 3924 -> 397 decryptions for node 2 over five
        // fms cycles, and 145 in cycle 1 across both nodes — exactly the
        // single-board figure, as it must be for the same work split two ways.
        nz.clear();
        for (int s = 0; s < n; ++s) if (!is_g_zero(sv.enc[s])) nz.push_back((uint16_t)s);
        reps.clear(); unit_of.clear();
        for (uint8_t li : queued) {
            const int8_t* row = sv.desc->enable + sv.constrained_gi[li] * n;
            size_t u = 0;
            for (; u < reps.size(); ++u) {
                const int8_t* other = sv.desc->enable + sv.constrained_gi[reps[u]] * n;
                bool same = true;
                for (uint16_t c : nz)
                    if ((pm_i8(row, c) != 0) != (pm_i8(other, c) != 0)) { same = false; break; }
                if (same) break;
            }
            if (u == reps.size()) reps.push_back(li);
            unit_of.push_back((uint8_t)u);
        }
        outs.assign(reps.size(), -1);
        for (size_t u = 0; u < reps.size(); ++u) {
            int e; bool dd;
            he_yield();
            if (row_decrypt(sv, sv.desc->enable + sv.constrained_gi[reps[u]] * n, n,
                            &e, &dd) == 0) {
                outs[u] = (int8_t)e; if (dd) ++g_step_decrypts;
            }
        }
        // A unit left at -1 means row_decrypt failed; those rows keep their bit.
        for (size_t k = 0; k < queued.size(); ++k)
            if (outs[unit_of[k]] >= 0) sv.cached_en[queued[k]] = outs[unit_of[k]];
    }
    g_in_he = false;
    return des_micros() - t0;
}

// This node's verdict, from already-decrypted cached bits. Events none of my
// supervisors constrain are, by definition, allowed by me.
static bool local_enabled(int gi) {
    for (auto& sv : g_sups)
        for (size_t li = 0; li < sv.constrained_gi.size(); ++li)
            if (sv.constrained_gi[li] == gi && !sv.cached_en[li]) return false;
    return true;
}

// =============================================================================
// 9. Partition — derived, never hardcoded
// =============================================================================

#ifdef DES_SUP_NODE_MAP
static const uint8_t g_sup_node_map[] = DES_SUP_NODE_MAP;
static_assert(sizeof(g_sup_node_map) == DES_NSUPS,
              "DES_SUP_NODE_MAP must list exactly one node per supervisor");
#endif

// Which node owns supervisor s. Default is a contiguous block partition, which
// keeps supervisors that share events together and so minimises the shared set.
// An explicit map entry outside 1..DES_NUM_NODES is refused at boot (see
// partition_ok); it would otherwise shift a bit mask by a negative amount.
static int node_of_sup(int s) {
#ifdef DES_SUP_NODE_MAP
    int n = g_sup_node_map[s];
    return (n >= 1 && n <= DES_NUM_NODES) ? n : 1;
#else
    return 1 + (int)((int64_t)s * DES_NUM_NODES / DES_NSUPS);
#endif
}

// Events a descriptor constrains or transitions on.
static uint32_t relevance_mask(const SupDesc* d) {
    int n = (int)pgm_read_word(&d->num_states);
    uint32_t m = 0;
    for (int gi = 0; gi < EVENT_COUNT; ++gi) {
        if (pm_u16(d->tcnt, gi) > 0) { m |= 1u << gi; continue; }
        for (int s = 0; s < n; ++s)
            if (!pm_i8(d->enable, gi*n + s)) { m |= 1u << gi; break; }
    }
    return m;
}

// Controllability is the one property the generated header does not carry, so
// it is inferred from the event label using the conventions these generators
// actually use, and can always be overridden with DES_CONTROLLABLE_MASK.
//
//   'a…' = activate/start  -> controllable      (a1,a2,a3 / b1,b2,b3 problems)
//   'b…' = finish/break    -> uncontrollable
//   otherwise: trailing digit ODD -> controllable   (Ramadge-Wonham numbering,
//              used by small_factory e1..e4 and by the FMS 11,12,21,22,… labels)
//
// Unknown labels default to CONTROLLABLE, which is the fail-safe direction: the
// node will ask permission before firing rather than act unilaterally.
static bool derive_controllable(int gi) {
#ifdef DES_CONTROLLABLE_MASK
    return ((uint32_t)(DES_CONTROLLABLE_MASK) >> gi) & 1u;
#else
    char nm[16]; ev_name(gi, nm);
    if (nm[0] == 'a') return true;
    if (nm[0] == 'b') return false;
    int last = -1;
    for (int i = 0; nm[i]; ++i) if (nm[i] >= '0' && nm[i] <= '9') last = nm[i] - '0';
    if (last >= 0) return (last & 1) != 0;
    return true;
#endif
}

static void build_routing() {
    for (int gi = 0; gi < EVENT_COUNT; ++gi) {
        g_route[gi].node_mask = 0;
        g_route[gi].controllable = derive_controllable(gi);
    }
    // Every node has every descriptor in flash (the header is shared), so each
    // can compute the full routing table locally. Only the supervisors assigned
    // to this node are ever encrypted or evaluated.
    for (int s = 0; s < DES_NSUPS; ++s) {
        uint32_t rel = relevance_mask(&DES_SUPS[s]);
        uint32_t bit = 1u << (node_of_sup(s) - 1);
        for (int gi = 0; gi < EVENT_COUNT; ++gi)
            if (rel >> gi & 1) g_route[gi].node_mask |= bit;
    }
    for (int gi = 0; gi < EVENT_COUNT; ++gi) {
        EvRoute& r = g_route[gi];
        r.shared = __builtin_popcount(r.node_mask) > 1;
        // Owner = lowest-numbered relevant node. Deterministic on every node,
        // which is what matters; override per plant if a specific machine's
        // actuator lives elsewhere.
        r.owner = 1;
        for (int n = 1; n <= DES_NUM_NODES; ++n)
            if (r.node_mask >> (n-1) & 1) { r.owner = (uint8_t)n; break; }
        r.part_mask = r.node_mask & ~(1u << (r.owner - 1));
    }
}

static bool partition_ok() {
#ifdef DES_SUP_NODE_MAP
    for (int s = 0; s < DES_NSUPS; ++s)
        if (g_sup_node_map[s] < 1 || g_sup_node_map[s] > DES_NUM_NODES) {
            DES_LOG("[FATAL] DES_SUP_NODE_MAP puts supervisor %d on node %d — "
                    "nodes are 1..%d\n", s, (int)g_sup_node_map[s], (int)DES_NUM_NODES);
            return false;
        }
#endif
    return true;
}

// Everything two nodes must agree on, hashed (FNV-1a). Computed from the
// DERIVED routing table rather than from the settings that produce it, so two
// builds that happen to agree on routing interoperate and any that do not are
// refused — whatever the reason they differ.
static uint32_t config_fingerprint() {
    uint32_t h = 2166136261u;
    auto mix = [&h](uint32_t v) {
        for (int i = 0; i < 4; ++i) { h ^= (v >> (8*i)) & 0xFF; h *= 16777619u; }
    };
    mix(DES_PROTO_VERSION); mix(DES_NUM_NODES);
    mix(DES_BENCH_LOCKSTEP); mix(EVENT_COUNT); mix(DES_NSUPS);
    for (int s = 0; s < DES_NSUPS; ++s)
        mix(pgm_read_word(&DES_SUPS[s].num_states));
    for (int gi = 0; gi < EVENT_COUNT; ++gi) {
        const EvRoute& r = g_route[gi];
        mix(r.node_mask); mix(r.owner); mix(r.controllable);
        char nm[16]; ev_name(gi, nm);
        for (int i = 0; nm[i]; ++i) mix((uint8_t)nm[i]);
    }
    mix(SIM_SEQ_LEN);
    for (int p = 0; p < SIM_SEQ_LEN; ++p) mix(pm_u16(SIM_SEQ, p));
    return h;
}

static inline bool i_am_owner(int gi)       { return g_route[gi].owner == DES_NODE_ID; }
static inline bool i_participate(int gi)    { return (g_route[gi].part_mask & g_my_node_bit) != 0; }
static inline bool i_am_relevant(int gi)    { return (g_route[gi].node_mask & g_my_node_bit) != 0; }

// =============================================================================
// 10. Loading, encryption, cache warm-up
// =============================================================================

static bool load_my_supervisors() {
    g_sups.clear();
    for (int s = 0; s < DES_NSUPS; ++s) {
        if (node_of_sup(s) != DES_NODE_ID) continue;
        g_sups.push_back(Supervisor());
        Supervisor& sv = g_sups.back();
        sv.desc = &DES_SUPS[s];
        sv.global_index = s;
        int n = (int)pgm_read_word(&sv.desc->num_states);

        for (int gi = 0; gi < EVENT_COUNT; ++gi) {
            if (pm_u16(sv.desc->tcnt, gi) > 0) sv.trans_event_mask |= (1u << gi);
            bool constrains = false;
            for (int st = 0; st < n && !constrains; ++st)
                if (!pm_i8(sv.desc->enable, gi*n + st)) constrains = true;
            if (constrains) sv.constrained_gi.push_back((uint8_t)gi);
        }
        sv.cached_en.assign(sv.constrained_gi.size(), 1);
        sv.changes_if_zero.assign(EVENT_COUNT, {});
        sv.changes_if_one .assign(EVENT_COUNT, {});

        // Conditional invariance: for each (event, row), can the row's
        // homomorphic OR-sum actually flip? Rows in neither list keep their
        // cached value and cost nothing.
        for (int ev = 0; ev < EVENT_COUNT; ++ev) {
            uint16_t pc = pm_u16(sv.desc->tcnt, ev);
            if (!pc) continue;
            int off = trans_offset(sv.desc, ev);
            std::vector<uint8_t> in_from(n, 0);
            std::vector<int16_t> to_of(n, -1);
            for (int p = 0; p < pc; ++p) {
                int f = pm_i16(sv.desc->trans + off*2, p*2);
                int t = pm_i16(sv.desc->trans + off*2, p*2+1);
                in_from[f] = 1; to_of[f] = (int16_t)t;
            }
            for (int li = 0; li < (int)sv.constrained_gi.size(); ++li) {
                int gi = sv.constrained_gi[li];
                const int8_t* row = sv.desc->enable + gi*n;
                bool any = false;
                for (int st = 0; st < n && !any; ++st) if (pm_i8(row, st)) any = true;
                if (!any) { sv.cached_en[li] = 0; continue; }
                bool z2o = false;
                for (int p = 0; p < pc && !z2o; ++p) {
                    int f = pm_i16(sv.desc->trans + off*2, p*2);
                    int t = pm_i16(sv.desc->trans + off*2, p*2+1);
                    if (!pm_i8(row, f) && pm_i8(row, t)) z2o = true;
                }
                if (z2o) sv.changes_if_zero[ev].push_back((uint8_t)li);
                bool o2z = false;
                for (int st = 0; st < n && !o2z; ++st) {
                    if (!pm_i8(row, st)) continue;
                    if (!in_from[st])             { o2z = true; break; }
                    if (!pm_i8(row, to_of[st]))   { o2z = true; break; }
                }
                if (o2z) sv.changes_if_one[ev].push_back((uint8_t)li);
            }
        }
        char nm[16];
        DES_LOG("[load] %-10s idx %d  %3d states  %2d constraining ev  %6u B ciphertext\n",
                sup_name(sv.desc, nm), s, n, (int)sv.constrained_gi.size(),
                (unsigned)(n * sizeof(Ciphertext)));
    }
    if (g_sups.empty())
        DES_LOG("[load] WARNING: no supervisor assigned to this node — it will "
                "act only as a participant.\n");
    return true;
}

static bool init_states() {
    for (auto& sv : g_sups) {
        int n = (int)pgm_read_word(&sv.desc->num_states);
        sv.enc.resize(n);
        sv_free_dec(sv); sv.dec_c1.resize(n); sv.dec_c2.resize(n);
        for (int s = 0; s < n; ++s) {
            mbedtls_ecp_point_init(&sv.dec_c1[s]); mbedtls_ecp_point_init(&sv.dec_c2[s]);
        }
        for (int s = 0; s < n; ++s) {
            DES_YIELD();
            if (elgamal_enc((int)pm_i8(sv.desc->init, s), &sv.enc[s], &g_drbg) != 0) return false;
            pt_decompress(sv.enc[s].c1, &sv.dec_c1[s]);
            pt_decompress(sv.enc[s].c2, &sv.dec_c2[s]);
        }
    }
    return true;
}

static void warm_cache() {
    for (auto& sv : g_sups)
        for (size_t li = 0; li < sv.constrained_gi.size(); ++li) {
            int n = (int)pgm_read_word(&sv.desc->num_states);
            int gi = sv.constrained_gi[li];
            int e; bool dd;
            DES_YIELD();
            if (row_decrypt(sv, sv.desc->enable + gi*n, n, &e, &dd) == 0)
                sv.cached_en[li] = (int8_t)e;
        }
}

static void crypto_init() {
    mbedtls_ecp_group_init(&g_grp);
    mbedtls_ecp_point_init(&g_G); mbedtls_ecp_point_init(&g_pub);
    mbedtls_mpi_init(&g_priv); mbedtls_mpi_init(&g_one); mbedtls_mpi_init(&g_neg_priv);
    mbedtls_ctr_drbg_init(&g_drbg); mbedtls_entropy_init(&g_entropy);
    mbedtls_mpi_lset(&g_one, 1);
    char pers[32]; snprintf(pers, sizeof(pers), "des_node_%d", (int)DES_NODE_ID);
    mbedtls_ctr_drbg_seed(&g_drbg, mbedtls_entropy_func, &g_entropy,
                          (const uint8_t*)pers, strlen(pers));
    mbedtls_ecp_group_load(&g_grp, DES_CURVE);
    mbedtls_ecp_copy(&g_G, &g_grp.G);
    // Each node has its OWN keypair. No ciphertext ever crosses the network,
    // so the nodes never need a shared key — no distributed key management,
    // no threshold crypto, no re-encryption.
    mbedtls_ecp_gen_keypair(&g_grp, &g_priv, &g_pub, mbedtls_ctr_drbg_random, &g_drbg);
    mbedtls_mpi_sub_mpi(&g_neg_priv, &g_grp.N, &g_priv);
    elgamal_enc(0, &g_zero, &g_drbg);
}

// =============================================================================
// 11. Cleartext oracles — on-board verification
// =============================================================================

struct ClearSup {
    const SupDesc*   desc = nullptr;
    int              n = 0;
    std::vector<int> st;
    void init(const SupDesc* d) {
        desc = d; n = (int)pgm_read_word(&d->num_states);
        st.assign(n, 0);
        for (int s = 0; s < n; ++s) st[s] = pm_i8(d->init, s);
    }
    bool constrains(int gi) const {
        for (int s = 0; s < n; ++s) if (!pm_i8(desc->enable, gi*n+s)) return true;
        return false;
    }
    bool enabled(int gi) const {
        if (!constrains(gi)) return true;
        for (int s = 0; s < n; ++s) if (pm_i8(desc->enable, gi*n+s) && st[s]) return true;
        return false;
    }
    // Returns false if the event emptied the state set — see oracle_step().
    bool step(int gi) {
        uint16_t pc = pm_u16(desc->tcnt, gi);
        if (!pc) return true;
        int off = trans_offset(desc, gi);
        std::vector<int> nxt(n, 0);
        // Union, not assignment — see the note in do_transition(). The oracle
        // must make the SAME correction, otherwise it would agree with a buggy
        // homomorphic path and the cross-check would validate nothing.
        bool any = false;
        for (uint16_t p = 0; p < pc; ++p) {
            int t = pm_i16(desc->trans, (off+p)*2+1);
            nxt[t] |= st[pm_i16(desc->trans, (off+p)*2)];
            any |= nxt[t] != 0;
        }
        st = nxt;
        return any;
    }
};

static std::vector<ClearSup> g_oracle;      // mirrors MY supervisors
static bool g_he_mismatch = false;
static void safe_halt(const char* why);     // section 12

#if DES_VERIFY_MONO && HAS_MONO && DES_BENCH_LOCKSTEP
static ClearSup g_mono;
static bool     g_mono_ok = true;
static uint32_t g_mono_steps = 0;
#  define DES_MONO_ACTIVE 1
#else
#  define DES_MONO_ACTIVE 0
#endif

// A supervisor that receives an event it has no transition for, from any state
// it could be in, is left with an EMPTY state set. It then disables everything
// it constrains, forever — and the oracle check still passes, because the
// encrypted and the clear copy agree perfectly on "empty". Before this check a
// run could degenerate into hundreds of SKIP lines with `oracle PASS` at the
// bottom. It only happens when an event is applied that the plant could not
// have produced from here — a replayed trace that has left the closed-loop
// language, or a model that does not match the plant — so it is a halt: the
// node no longer knows what state the plant is in.
static void oracle_step(int gi) {
    for (auto& o : g_oracle) {
        if (o.step(gi)) continue;
        char nm[16], sn[16];
        DES_LOG("\n[!!] %s has NO transition on %s from any state it could be in "
                "(c%d s%d) — its state set is now empty\n", sup_name(o.desc, sn),
                ev_name(gi, nm), g_cycle, g_step);
        safe_halt("a supervisor received an event its model says cannot happen "
                  "from here — plant and model disagree");
        return;
    }
}
static void oracle_verify(const char* ctx) {
    for (int gi = 0; gi < EVENT_COUNT; ++gi) {
        bool he = local_enabled(gi);
        bool cl = true;
        for (auto& o : g_oracle) if (!o.enabled(gi)) { cl = false; break; }
        if (he != cl) {
            char nm[16];
            DES_LOG("  [!!] HE/oracle MISMATCH on %s after %s: HE=%d clear=%d\n",
                    ev_name(gi, nm), ctx, (int)he, (int)cl);
            g_he_mismatch = true;
        }
    }
}
// Safety gate: nothing may fire that the centralised supervisor forbids.
static void mono_check_and_step(int gi, const char* how) {
#if DES_MONO_ACTIVE
    char nm[16];
    if (!g_mono.enabled(gi)) {
        DES_LOG("  [!!] SAFETY: %s (%s) fired but the MONOLITHIC supervisor "
                "disables it\n", ev_name(gi, nm), how);
        g_mono_ok = false;
    } else { g_mono.step(gi); ++g_mono_steps; }
#else
    (void)gi; (void)how;
#endif
}

// =============================================================================
// 12. Transport plumbing
// =============================================================================

static void tx(uint8_t type, uint8_t ev, uint32_t seq, uint8_t vote = 0,
               uint32_t occ = 0) {
    DesFrame f; memset(&f, 0, sizeof(f));
    f.magic = DES_MAGIC; f.type = type; f.src = DES_NODE_ID;
    f.ev = ev; f.vote = vote; f.seq = seq; f.occ = occ;
    f.epoch = g_epoch; f.cfg = g_cfg; f.ctr = ++g_ctr_tx;
    des_mac(f, f.tag);
    DES_TRANSPORT_IMPL.send(&f, sizeof(f));
    ++g_tx;
}

static void safe_halt(const char* why) {
    if (g_safe_halt) return;
    g_safe_halt = true; g_halt_why = why;
    // Said three times, and repeated to any peer still talking (see dispatch):
    // on a lossy link a single HALT went missing and the peer then waited out
    // a two-minute timeout on every remaining step.
    for (int k = 0; k < 3; ++k) tx(M_HALT, 0xFF, g_my_seq);
    DES_LOG("\n############################################################\n");
    DES_LOG("  SAFE HALT on node %d: %s\n", (int)DES_NODE_ID, why);
    DES_LOG("  tx=%u rx=%u retx=%u\n", (unsigned)g_tx, (unsigned)g_rx, (unsigned)g_retx);
    DES_LOG("  This node cannot prove its peers are in the same state, so it\n");
    DES_LOG("  refuses to act further. Safety preserved, liveness is not —\n");
    DES_LOG("  the Two Generals trade, made explicit.\n");
    DES_LOG("############################################################\n\n");
}

// Apply a shared event committed by its owner. Idempotent under retransmission.
//
// Why there is no gap check. A per-sender sequence number cannot tell a lost
// commit from a commit this node was never part of: with three nodes the owner
// may commit s-1 with node 2 and s with node 3, and node 3 then sees a "gap"
// that is nothing of the sort. And a genuinely lost commit cannot happen at
// all: the owner does not move on until EVERY participant has acknowledged,
// and a participant only acknowledges what it has accepted. The one real way
// to miss commits is a reboot, and that is caught directly by the epoch. So the
// sequence number is used for what it can actually do — reject duplicates —
// and nothing else.
static void participant_apply(const DesFrame& f) {
    char nm[16];
    // Multicast reaches every node. Only participants apply, and only they
    // acknowledge: an ACK from anyone else is not in the owner's `need` mask.
    if (!i_participate(f.ev)) return;
    uint32_t* last = &g_seq_from[f.src];
    if (f.seq <= *last) { tx(M_ACK, f.ev, f.seq); return; }        // duplicate
    // PLANT CHECK, participant side (see fire()). Only a NOTIFY can get here
    // disabled: for a COMMIT this node voted yes and has been locked since. An
    // uncontrollable event cannot be refused — the owner reports it happened —
    // but applying one our supervisors say no machine could produce would empty
    // their state. The two nodes' models no longer agree, so halt instead.
    if (!local_enabled(f.ev)) {
        ++g_impossible;
        DES_REACT_TAG();
        DES_LOG("[!!]   %-4s  IMPOSSIBLE — reported by node %d, but no machine could "
                "produce it here\n", ev_name(f.ev, nm), (int)f.src);
        safe_halt("a peer reported an event this node's model says no machine "
                  "could produce");
        return;
    }
    // ACCEPT AND ACKNOWLEDGE FIRST, APPLY SECOND.
    //
    // The apply is a full homomorphic step: measured at 3-4 s for one `fms`
    // event, because a participant can owe dozens of scalar multiplications.
    // Acknowledging only afterwards would make the initiator wait that long on
    // every shared event, and dispatch is deferred for the whole step, so its
    // retransmissions would not be answered either.
    //
    // The sequence number is recorded before the ACK, so a retransmitted COMMIT
    // is still deduplicated by the check above and this node is committed to
    // applying the event. The ACK therefore means "accepted, and I will apply
    // it", not "already applied" — which is what two-phase commit actually
    // requires of a participant, and is why a real 2PC logs before it votes.
    *last = f.seq;
    if (g_lock_by == f.src) g_lock_by = 0;                          // release
    tx(M_ACK, f.ev, f.seq);

    uint64_t he = he_step(f.ev);
    oracle_step(f.ev);
    mono_check_and_step(f.ev, "participant");
    oracle_verify(ev_name(f.ev, nm));
    if (f.occ > g_resolved_occ[f.ev]) g_resolved_occ[f.ev] = f.occ;
    g_acc_part.add(he, 0, he);
    DES_REACT_TAG();
    DES_LOG("apply  %-4s  %8.1f ms HE  %3d dec  from node %d  (seq %u)\n",
            ev_name(f.ev, nm), he/1000.0, g_step_decrypts, (int)f.src, (unsigned)f.seq);
}

// Act on one queued frame. Never called while a homomorphic step is in
// flight — several of these branches call he_step() or read `cached_en`.
// Ask `node` to prove the epoch it is running NOW: a fresh 64-bit nonce it
// must send back in a tagged M_RESP. At most one challenge per node per
// 250 ms, answered or not: limiting only while one was pending let every
// replayed frame trigger a fresh round trip (measured: 258 challenges under a
// 615-frame replay) — an attacker sending one frame made the cell send two.
static void challenge(uint8_t node) {
    if (g_chal_t[node] && des_millis() - g_chal_t[node] < 250) return;
    mbedtls_ctr_drbg_random(&g_drbg, (unsigned char*)&g_chal_lo[node], 4);
    mbedtls_ctr_drbg_random(&g_drbg, (unsigned char*)&g_chal_hi[node], 4);
    g_chal_pending[node] = true; g_chal_t[node] = des_millis();
    ++g_challenges;
    tx(M_CHAL, 0, g_chal_lo[node], node, g_chal_hi[node]);
}

// `f` answered our challenge, so its epoch is live, not a recording. If that
// epoch is new, the peer rebooted: its supervisors are back in their initial
// state and its commit sequence restarted at 1. Harmless if nothing shared has
// happened between us yet — it simply rejoins. Otherwise the two sides no
// longer describe the same plant, and there is no honest way on.
static void confirm_epoch(const DesFrame& f) {
    uint32_t& known = g_epoch_from[f.src];
    if (known && known != f.epoch) {
        bool history = g_seq_from[f.src] || g_ann_from[f.src] || g_my_seq;
        if (history) {
            DES_LOG("[!!] node %d RESTARTED mid-run\n", (int)f.src);
            known = f.epoch; g_ctr_from[f.src] = f.ctr;
            safe_halt("a peer restarted after shared events had been "
                      "committed — its supervisors no longer match ours");
            return;
        }
        DES_LOG("[net] node %d restarted before any shared event — "
                "letting it rejoin\n", (int)f.src);
        memset(g_at_occ[f.src], 0, sizeof(g_at_occ[f.src]));
        g_ctr_from[f.src] = f.ctr;
    } else if (!known) {
        g_ctr_from[f.src] = f.ctr;
    } else if (f.ctr > g_ctr_from[f.src]) {
        g_ctr_from[f.src] = f.ctr;               // same epoch: a replay was probed
    }
    known = f.epoch;
    g_peer_seen |= 1u << (f.src - 1);
}

static void dispatch(const DesFrame& f) {
    {
        char nm[16];

        // ---- freshness (see 6a) ----------------------------------------
        // The challenge handshake runs before the epoch gate: it is how an
        // epoch gets past the gate at all.
        if (f.type == M_CHAL) {
            if (f.vote == DES_NODE_ID) tx(M_RESP, 0, f.seq, f.src, f.occ);
            return;
        }
        if (f.type == M_RESP) {
            if (f.vote == DES_NODE_ID && g_chal_pending[f.src] &&
                f.seq == g_chal_lo[f.src] && f.occ == g_chal_hi[f.src]) {
                g_chal_pending[f.src] = false;
                if (f.src != DES_NODE_ID) {
                    confirm_epoch(f);
                } else if (!g_dup_id) {
                    // A live board — not a recording: it just answered a nonce
                    // we made up — is running with our DES_NODE_ID.
                    g_dup_id = true;
                    DES_LOG("\n[!!] ANOTHER BOARD IS ALSO CONFIGURED AS NODE %d — "
                            "reflash one of them with a different DES_NODE_ID\n\n",
                            (int)DES_NODE_ID);
                }
            }
            return;
        }
        // Validly tagged, our id, not our epoch: a second board with our id, or
        // a recording of an earlier boot of ours. Only a live board can answer.
        if (f.src == DES_NODE_ID) { challenge(DES_NODE_ID); return; }
        // An epoch we have not confirmed — a peer's first frames, its reboot,
        // or a recording. Not acted on until the peer proves it is current.
        if (f.epoch != g_epoch_from[f.src]) { challenge(f.src); return; }
        // Right epoch, but a counter we have already passed: a replay.
        if (f.ctr <= g_ctr_from[f.src]) { ++g_replays; return; }
        g_ctr_from[f.src] = f.ctr;
        g_peer_seen |= 1u << (f.src - 1);

        // A peer that is still sending has not heard that we stopped.
        static uint32_t halt_echo_t = 0;
        if (g_safe_halt && f.type != M_HALT && des_millis() - halt_echo_t > 500) {
            halt_echo_t = des_millis();
            tx(M_HALT, 0xFF, g_my_seq);
        }

        switch (f.type) {
        case M_HELLO: break;
        case M_PING:  tx(M_PONG, f.ev, f.seq); g_run_t0 = des_micros(); break;

        case M_REQ: {
            if (!i_participate(f.ev)) break;             // not ours to vote on
            if (g_safe_halt) { tx(M_VOTE, f.ev, f.seq, 0); break; }
            // Wound-wait, initiator side. If I am committing my own
            // transaction, I am busy. If I am still collecting votes, the
            // lower-numbered (older) initiator wins: a younger requester is
            // told no, an older one wounds me — I will abort mine — and is
            // then judged like any other request.
            if (g_init_phase == 2 || (g_init_phase == 1 && f.src > DES_NODE_ID)) {
                tx(M_VOTE, f.ev, f.seq, 0);
                break;
            }
            if (g_init_phase == 1) g_wounded = true;
            // A YES already cast is never withdrawn, whoever asks: its
            // initiator may have committed on it, and nothing would tell it the
            // vote was gone — the two-phase-commit rule that a prepared
            // participant cannot abort on its own. The refusal is immediate,
            // so no initiator ever waits on another's lock and no cycle of
            // waits can form; the refused one aborts, having applied nothing,
            // and backs off before retrying (drive_one).
            if (lock_held() && g_lock_by != f.src) {
                tx(M_VOTE, f.ev, f.seq, 0);                          // busy -> no
                break;
            }
            bool ok = local_enabled(f.ev);
            if (ok) { g_lock_by = f.src; g_lock_t0 = des_millis(); }
            tx(M_VOTE, f.ev, f.seq, ok ? 1 : 0);
            DES_REACT_TAG();
            DES_LOG("vote   %-4s  %-3s to node %d          (seq %u)\n",
                    ev_name(f.ev, nm), ok ? "YES" : "NO", (int)f.src, (unsigned)f.seq);
            break;
        }
        case M_ABORT:
            if (g_lock_by == f.src) g_lock_by = 0;
            break;

        case M_COMMIT:
        case M_NOTIFY:
            if (!g_safe_halt) participant_apply(f);
            break;

        case M_ANNOUNCE:
            // Lockstep instrumentation only. Participants already applied this
            // event through COMMIT/NOTIFY, so they ignore it; everyone else
            // uses it to keep event counters and the monolithic replay aligned.
            // Its own sequence space keeps a lost announcement from being
            // mistaken for a lost commit.
            if (i_participate(f.ev))          break;
            if (f.seq <= g_ann_from[f.src])   break;
            g_ann_from[f.src] = f.seq;
            he_step(f.ev);
            oracle_step(f.ev);
            mono_check_and_step(f.ev, "remote");
            if (f.occ > g_resolved_occ[f.ev]) g_resolved_occ[f.ev] = f.occ;
            break;

        case M_SKIP:
            // The owner could not fire this occurrence and moved on. Before
            // this case existed the frame was sent and silently dropped, so a
            // participant waited out its whole timeout for an event its owner
            // had already given up on. Idempotent: a repeat changes nothing.
            if (f.occ > g_resolved_occ[f.ev]) {
                g_resolved_occ[f.ev] = f.occ;
                DES_REACT_TAG();
                DES_LOG("skip   %-4s  node %d gave up on it — moving on too"
                        "  (occ %u)\n", ev_name(f.ev, nm), (int)f.src,
                        (unsigned)f.occ);
            }
            break;

        case M_AT:
            if (f.occ > g_at_occ[f.src][f.ev]) g_at_occ[f.src][f.ev] = f.occ;
            break;

        case M_HALT:
            DES_LOG("[!!] node %d reported SAFE HALT\n", (int)f.src);
            safe_halt("a peer halted");
            break;

        case M_VOTE:
        case M_ACK:
        case M_PONG:
            // Tallied straight into the pending wait, one bit per node. A single
            // "last reply" slot used to be overwritten when two replies arrived
            // in the same drain of the queue, so one of them was never counted
            // and the initiator retransmitted for nothing.
            if (f.type == g_await_type && f.seq == g_await_seq) {
                g_await_got |= (1u << (f.src - 1)) & g_await_need;
                if (f.type == M_VOTE && !f.vote) g_await_no = true;
            }
            break;
        }
    }
}

// Drain the socket, then act on what is queued. Dispatch is suppressed while a
// homomorphic step is in flight: the frames stay queued and are handled the
// moment the step returns, which is what lets he_step() keep the socket clear
// without re-entering itself.
static void pump() {
    he_yield();
    if (g_in_he) return;
    while (g_rxq_tail != g_rxq_head) {
        DesFrame f = g_rxq[g_rxq_tail];
        g_rxq_tail = (uint16_t)((g_rxq_tail + 1) & (DES_RXQ_LEN - 1));
        dispatch(f);
    }
}

static void pump_delay(uint32_t ms) {
    uint32_t t0 = des_millis();
    while (des_millis() - t0 < ms) { pump(); des_sleep_ms(2); }
}

// Collect one reply type from every node in `need`, or time out.
// Returns the mask of nodes that answered — never more than `need`, so a reply
// from a node outside the transaction cannot make "everyone answered" false —
// and `all_yes` reports vote unanimity.
static uint32_t collect(uint8_t type, uint32_t seq, uint32_t need,
                        uint32_t timeout_ms, bool* all_yes) {
    g_await_type = type; g_await_seq = seq; g_await_need = need;
    g_await_got  = 0;    g_await_no  = false;
    uint32_t t0 = des_millis();
    while (g_await_got != need && des_millis() - t0 < timeout_ms && !g_safe_halt) {
        pump();
        des_sleep_ms(1);
    }
    uint32_t got = g_await_got;
    if (all_yes) *all_yes = !g_await_no;
    g_await_type = 0;
    return got;
}

// =============================================================================
// 13. Firing an event
// =============================================================================

// FIRE_VETOED is kept distinct from FIRE_BLOCKED because the two call for
// opposite retry policies. A missing quorum is a transient network condition
// and re-asking soon is right. A veto is a *decision*: a peer's supervisor
// currently disables the event, and only a state change on that peer can lift
// it. Re-asking every 50 ms until the step timeout — which is what the driver
// used to do — sends ~150 requests per blocked event, and that flood is
// precisely what overruns a busy peer's receive mailbox.
// FIRE_IMPOSSIBLE is final: an uncontrollable event this node's supervisors say
// no machine could produce from here. Waiting will not make it possible.
enum FireResult { FIRE_OK, FIRE_BLOCKED, FIRE_VETOED, FIRE_HALT, FIRE_IMPOSSIBLE };

// The veto log is rate-limited: the first refusal of an event is printed in
// full, the repeats are counted and rolled up by the driver when the wait ends.
static int      g_veto_ev     = -1;
static uint32_t g_veto_repeat = 0;
static const char* g_block_why = "";      // why the last FIRE_BLOCKED happened

static FireResult fire(int gi, uint32_t occ, uint64_t* he_us, uint64_t* net_us) {
    *he_us = 0; *net_us = 0;
    if (g_safe_halt) return FIRE_HALT;
    char nm[16]; ev_name(gi, nm);
    const EvRoute& r = g_route[gi];

    // A peer holds my lock: I voted YES on its event and have not yet seen its
    // COMMIT or ABORT. My vote was a promise about my current state, so I may
    // not change that state — not even with a purely local event — until the
    // transaction settles. drive_one() retries shortly.
    if (lock_held()) {
        g_block_why = "a peer's transaction kept this node locked";
        return FIRE_BLOCKED;
    }

    // Phase 0 — my own verdict. A cached bit: no crypto, no traffic.
    // Only CONTROLLABLE events may be held back; an uncontrollable one has
    // already happened in the plant, and a supervisor may not disable it.
    if (!local_enabled(gi)) {
        if (r.controllable) {
            g_block_why = "my own supervisor disables it here";
            return FIRE_BLOCKED;
        }
        // PLANT CHECK. A synthesised supervisor never disables an uncontrollable
        // event the plant can produce — that is what controllability means. So
        // if ours disable it, no machine could have produced it from here: a
        // sensor fault, a forged report, or a model that does not match the
        // plant. Applying it would empty the supervisors' state; reject it.
        ++g_impossible;
        g_block_why = "physically impossible here — rejected";
        DES_STEP_TAG();
        DES_LOG("[!!]   %-4s  IMPOSSIBLE — uncontrollable, but no machine could "
                "produce it from here; rejected (sensor fault or attack?)\n", nm);
        return FIRE_IMPOSSIBLE;
    }

    // ---- local event: nobody else cares. Zero frames. ----
    if (!r.shared) {
        mono_check_and_step(gi, "local");
        *he_us = he_step(gi);
        oracle_step(gi);
        oracle_verify(nm);
        // MUST use the announcement counter, never g_my_seq. g_my_seq is the
        // gap-checked COMMIT sequence that participants validate with
        // `seq == last + 1`; bumping it here inflates it by the number of local
        // events fired, so the first real shared event arrives with a sequence
        // the peer reads as a gap and safe-halts on.
#if DES_BENCH_LOCKSTEP
        tx(M_ANNOUNCE, (uint8_t)gi, ++g_ann_seq, 0, occ);
#endif
        DES_STEP_TAG();
        DES_LOG("local  %-4s  %8.1f ms HE  %3d dec  %d frames\n",
                nm, *he_us/1000.0, g_step_decrypts, (int)(DES_BENCH_LOCKSTEP ? 1 : 0));
        return FIRE_OK;
    }

    // ---- shared event ----
    uint32_t seq  = g_my_seq + 1;
    uint32_t need = r.part_mask;
    uint64_t tn0  = des_micros();
    uint8_t  kind = r.controllable ? M_COMMIT : M_NOTIFY;

    // A controllable event needs every participant's PERMISSION. An
    // uncontrollable one cannot be refused — SCT forbids it, and in a real
    // cell the machine has already done it — so it is simply notified.
    if (r.controllable) {
        // Two-phase commit across every participant.
        g_init_phase = 1; g_wounded = false;
        bool granted = false;
        for (int a = 0; a < DES_REQ_RETRIES && !granted && !g_wounded; ++a) {
            if (a) ++g_retx;
            tx(M_REQ, (uint8_t)gi, seq);
            bool yes = true;
            uint32_t got = collect(M_VOTE, seq, need, DES_REQ_TIMEOUT_MS, &yes);
            if (g_wounded) break;
            if (got != need) continue;                       // resend
            if (!yes) {
                *net_us = des_micros() - tn0;
                tx(M_ABORT, (uint8_t)gi, seq);
                g_init_phase = 0;
                if (g_veto_ev != gi) {
                    g_veto_ev = gi; g_veto_repeat = 0;
                    DES_STEP_TAG();
                    DES_LOG("veto   %-4s  a peer's supervisor disables it here"
                            "  (%.1f ms)\n", nm, *net_us/1000.0);
                } else {
                    ++g_veto_repeat;
                }
                return FIRE_VETOED;
            }
            granted = true;
        }
        if (!granted || g_wounded) {
            // No unanimous vote, or an older transaction preempted this one.
            // NOTHING was applied anywhere, so this is harmless — retry later.
            *net_us = des_micros() - tn0;
            tx(M_ABORT, (uint8_t)gi, seq);
            g_init_phase = 0;
            DES_STEP_TAG();
            if (g_wounded)
                DES_LOG("yield  %-4s  an older transaction preempted this one — "
                        "nothing applied, will retry\n", nm);
            else
                DES_LOG("retry  %-4s  no quorum after %d tries — nothing applied "
                        "anywhere\n", nm, DES_REQ_RETRIES);
            g_block_why = g_wounded ? "kept yielding to older transactions"
                                    : "no quorum — a peer never answered";
            g_wounded = false;
            return FIRE_BLOCKED;
        }
        g_init_phase = 2;
    }

    // The decision is final: every participant said yes (or, for an
    // uncontrollable event, there was nothing to ask). So announce it FIRST and
    // apply it here second. Applying first kept every participant locked for
    // the whole of this node's homomorphic step, long enough on a heavy node to
    // outlast DES_LOCK_TIMEOUT_MS; announcing first releases them at once and
    // lets their step run in parallel with ours.
    g_my_seq = seq;
    tx(kind, (uint8_t)gi, seq, 0, occ);
    mono_check_and_step(gi, r.controllable ? "2pc" : "notify");
    *he_us = he_step(gi);
    oracle_step(gi);
    oracle_verify(nm);

    uint32_t acked = collect(M_ACK, seq, need, DES_ACK_TIMEOUT_MS, nullptr);
    for (int a = 1; a < DES_ACK_RETRIES && acked != need; ++a) {
        ++g_retx;
        tx(kind, (uint8_t)gi, seq, 0, occ);
        acked |= collect(M_ACK, seq, need, DES_ACK_TIMEOUT_MS, nullptr);
    }
    g_init_phase = 0;
    *net_us = des_micros() - tn0 - *he_us;
    if (acked != need) {
        safe_halt(r.controllable
            ? "COMMIT unacknowledged — a participant may not have applied a shared event"
            : "NOTIFY unacknowledged — a participant may have missed an "
              "uncontrollable shared event");
        return FIRE_HALT;
    }
#if DES_BENCH_LOCKSTEP
    // Nodes outside this event still walk the whole trace in lockstep and
    // must learn it happened. Participants ignore the announcement.
    tx(M_ANNOUNCE, (uint8_t)gi, ++g_ann_seq, 0, occ);
#endif
    DES_STEP_TAG();
    DES_LOG("%-6s %-4s  %8.1f ms HE  %3d dec  %d frames  + %.1f ms peer-wait"
            "  (seq %u)\n", r.controllable ? "2pc" : "notify", nm, *he_us/1000.0,
            g_step_decrypts,
            r.controllable ? 2 + 2*__builtin_popcount(need) : 1 + __builtin_popcount(need),
            *net_us/1000.0, (unsigned)seq);
    return FIRE_OK;
}

// =============================================================================
// 14. Reporting
// =============================================================================

static void print_partition() {
    char nm[16];
    DES_LOG("--- event routing (DERIVED from the header, not hardcoded) ---\n");
    DES_LOG("  %-6s %-5s %-10s %-6s %s\n", "event", "ctrl", "nodes", "owner", "class");
    int nshared = 0, nmine = 0;
    for (int gi = 0; gi < EVENT_COUNT; ++gi) {
        const EvRoute& r = g_route[gi];
        // snprintf returns the length it WOULD have written, so an unguarded
        // `p +=` walks past the buffer once it fills (about 13 nodes here).
        char nodes[40] = ""; int p = 0;
        for (int n = 1; n <= DES_NUM_NODES && p < (int)sizeof(nodes) - 1; ++n)
            if (r.node_mask >> (n-1) & 1) p += snprintf(nodes+p, sizeof(nodes)-p, "%d ", n);
        if (p >= (int)sizeof(nodes) - 1) p = (int)sizeof(nodes) - 1;
        if (!p) snprintf(nodes, sizeof(nodes), "-");
        if (r.shared) ++nshared;
        if (i_am_relevant(gi)) ++nmine;
        DES_LOG("  %-6s %-5s %-10s %-6d %s\n", ev_name(gi, nm),
                r.controllable ? "yes" : "no", nodes, (int)r.owner,
                r.shared ? "SHARED — needs network" : "local — no network");
    }
    DES_LOG("  => %d/%d events shared; %d/%d need ZERO network traffic; "
            "%d concern this node\n",
            nshared, EVENT_COUNT, EVENT_COUNT - nshared, EVENT_COUNT, nmine);
#ifndef DES_CONTROLLABLE_MASK
    DES_LOG("  NOTE controllability was INFERRED from event labels (the header\n");
    DES_LOG("       does not carry it). Check the 'ctrl' column above; if it is\n");
    DES_LOG("       wrong, set DES_CONTROLLABLE_MASK explicitly.\n");
#endif
    DES_LOG("\n");
}

static void print_acc(const char* label, const Acc& a, uint64_t tot) {
    if (!a.n) { DES_LOG("  %-22s       (none on this node)\n", label); return; }
    DES_LOG("  %-22s n=%-4u avg %8.2f ms  (HE %7.2f + net %7.2f)  "
            "min %7.2f  max %8.2f",
            label, (unsigned)a.n, (a.wall/(double)a.n)/1000.0,
            (a.he/(double)a.n)/1000.0, (a.net/(double)a.n)/1000.0,
            a.wmin/1000.0, a.wmax/1000.0);
    if (tot) DES_LOG("  %5.1f%%", 100.0*a.wall/tot);
    DES_LOG("\n");
}

static void print_summary() {
    uint64_t tot = g_acc_local.wall + g_acc_ctrl.wall + g_acc_unctrl.wall;
    uint64_t he  = g_acc_local.he   + g_acc_ctrl.he   + g_acc_unctrl.he;
    uint64_t net = g_acc_local.net  + g_acc_ctrl.net  + g_acc_unctrl.net;
    uint32_t n   = g_acc_local.n + g_acc_ctrl.n + g_acc_unctrl.n;

    DES_LOG("\n============================================================\n");
    DES_LOG("  SUMMARY — node %d/%d — %s — %s\n", (int)DES_NODE_ID, (int)DES_NUM_NODES,
            DES_FAMILY_NAME, DES_TRANSPORT_IMPL.name);
    DES_LOG("============================================================\n");
    DES_LOG("  events this node FIRED:\n");
    print_acc("local (no network)",  g_acc_local,  tot);
    print_acc("shared controllable", g_acc_ctrl,   tot);
    print_acc("shared uncontroll.",  g_acc_unctrl, tot);
    DES_LOG("  events this node APPLIED for a peer (participant side):\n");
    print_acc("shared, applied",     g_acc_part,   0);
    if (g_sync_n)
        DES_LOG("  sync-wait (peers reaching a shared step): n=%u avg %.2f ms, "
                "%.1f s total\n     not protocol cost — the plant catching up; "
                "kept out of the rows above\n", (unsigned)g_sync_n,
                (g_sync_us / (double)g_sync_n) / 1000.0, g_sync_us / 1e6);
    if (g_cycles_done) {
        DES_LOG("  run clock, end of cycles 1..%d (ms):", g_cycles_done);
        for (int c = 0; c < g_cycles_done; ++c) DES_LOG(" %.1f", g_cycle_end_ms[c]);
        DES_LOG("\n     a cycle is over at the LATEST node's value; "
                "DES_WORK_MS %d included\n", (int)DES_WORK_MS);
    }
    DES_LOG("  ----------------------------------------------------------\n");
    if (n) {
        DES_LOG("  all events            n=%-4u avg %8.2f ms  (HE %7.2f + net %7.2f)\n",
                (unsigned)n, (tot/(double)n)/1000.0, (he/(double)n)/1000.0,
                (net/(double)n)/1000.0);
        // Deliberately NOT called "network overhead". The measured round-trip
        // on this link is 10-25 ms, while this figure reaches thousands: what
        // it times is an initiator blocked on a participant that is busy doing
        // its own homomorphic work. The dominant cost of a distributed
        // encrypted supervisor is peer computation serialised behind a commit,
        // not the wire. Calling it network overhead invites exactly the wrong
        // conclusion — that a faster link would help.
        DES_LOG("  PEER-WAIT + WIRE      %.1f %% of total step time\n",
                tot ? 100.0*net/tot : 0.0);
        DES_LOG("     (compare against the round-trip probe above: the excess is\n");
        DES_LOG("      the peer's own HE work, not the link.)\n");
    }
    DES_LOG("  frames: tx=%u rx=%u retransmits=%u\n",
            (unsigned)g_tx, (unsigned)g_rx, (unsigned)g_retx);
    DES_LOG("  authentication: HMAC-SHA256/128, %.1f us per frame; %u rejected "
            "(bad tag), %u stale/replayed dropped, %u epoch challenges\n", g_mac_us,
            (unsigned)g_auth_bad, (unsigned)g_replays, (unsigned)g_challenges);
    DES_LOG("  rx queue: peak %u/%u frames", (unsigned)g_rxq_peak, (unsigned)DES_RXQ_LEN);
    if (g_rxq_drops) DES_LOG(", %u DROPPED (queue full — raise DES_RXQ_LEN)",
                             (unsigned)g_rxq_drops);
    DES_LOG("\n");
    DES_LOG("  plant check: %u event report%s rejected as physically impossible\n",
            (unsigned)g_impossible, g_impossible == 1 ? "" : "s");
    DES_LOG("     (%s)\n", DES_FAMILY_HAS_PLANT
            ? "these supervisors carry the plant: an impossible uncontrollable "
              "event is caught"
            : "REDUCED supervisors do not carry the plant: an impossible event "
              "may be accepted");
    if (g_skips) {
        DES_LOG("  !! %u STEPS SKIPPED — each SKIP line above says why. Firing a\n",
                (unsigned)g_skips);
        DES_LOG("     step anyway would corrupt every supervisor downstream.\n");
    }
    if (g_dup_id)
        DES_LOG("  !! another board is configured with this same DES_NODE_ID\n");
    if (g_cfg_bad_from) {
        DES_LOG("  !! ignored nodes running a different configuration:");
        for (int k = 1; k <= DES_NUM_NODES; ++k)
            if (g_cfg_bad_from >> (k-1) & 1) DES_LOG(" %d", k);
        DES_LOG("\n");
    }
#if DES_SIMULATE_LOSS_PCT > 0
    DES_LOG("  injected frame loss: %d %%\n", (int)DES_SIMULATE_LOSS_PCT);
#endif
#if DES_BENCH_LOCKSTEP
    DES_LOG("  NOTE lockstep is ON — local events also announce themselves, so\n");
    DES_LOG("       the frame count is higher than a deployment would need.\n");
#endif
    DES_LOG("  ----------------------------------------------------------\n");
    DES_LOG("  homomorphic vs cleartext oracle : %s\n",
            g_he_mismatch ? "FAIL — HE diverged from the clear model"
                          : "PASS — every encrypted bit matched");
    DES_LOG("     (PASS certifies the cryptography: each node's encrypted bits\n");
    DES_LOG("      match its own clear model for the events it applied. It does\n");
    DES_LOG("      not certify the distributed run — read the skips for that.)\n");
#if DES_MONO_ACTIVE
    DES_LOG("  distributed vs MONOLITHIC sup.  : %s (%u events replayed)\n",
            g_mono_ok ? "PASS — nothing fired that the centralised supervisor forbids"
                      : "FAIL — safety violation, see log",
            (unsigned)g_mono_steps);
#elif DES_VERIFY_MONO
    // Asked for, but not possible in this build — say so rather than let the
    // line silently vanish from the summary.
#  if HAS_MONO
    DES_LOG("  distributed vs MONOLITHIC sup.  : off — needs DES_BENCH_LOCKSTEP 1 "
            "(every node must see every event)\n");
#  else
    DES_LOG("  distributed vs MONOLITHIC sup.  : off — this header has no "
            "monolithic supervisor\n");
#  endif
#endif
    DES_LOG("  safe halt                       : %s\n",
            g_safe_halt ? g_halt_why : "no — ran to completion");
    DES_LOG("============================================================\n");
}

// =============================================================================
// 15. Self-test + transport probe
// =============================================================================

static bool run_selftest() {
    DES_LOG("--- crypto self-test ---\n");
    bool ok = true;
    Ciphertext a, b, s; int d0 = -1, d1 = -1, ds = -1;
    elgamal_enc(0, &a, &g_drbg); elgamal_enc(1, &b, &g_drbg);
    elgamal_dec(&a, &d0); elgamal_dec(&b, &d1);
    ok &= (d0 == 0 && d1 == 1);
    DES_LOG("  Enc(0)->%d Enc(1)->%d                %s\n", d0, d1,
            (d0==0&&d1==1) ? "PASS" : "FAIL");
    elgamal_add(&b, &b, &s); elgamal_dec(&s, &ds); ok &= (ds == 1);
    DES_LOG("  Enc(1)+Enc(1)->%d homomorphic OR   %s\n", ds, ds==1 ? "PASS":"FAIL");
    elgamal_add(&a, &a, &s); ds = -1; elgamal_dec(&s, &ds); ok &= (ds == 0);
    DES_LOG("  Enc(0)+Enc(0)->%d                  %s\n", ds, ds==0 ? "PASS":"FAIL");
    DES_LOG("  curve %s, ciphertext %u B    %s\n", DES_CURVE_NAME,
            (unsigned)sizeof(Ciphertext), ok ? "PASS" : "FAIL");
    {   // Frame authentication: its cost per frame, and that it notices a
        // single flipped bit.
        DesFrame g; memset(&g, 0, sizeof(g));
        uint64_t t0 = des_micros();
        for (int i = 0; i < 100; ++i) des_mac(g, g.tag);
        g_mac_us = (des_micros() - t0) / 100.0;
        bool good = des_mac_ok(g);
        g.seq ^= 1u;
        bool caught = !des_mac_ok(g);
        ok &= good && caught;
        DES_LOG("  frame tag HMAC-SHA256/128: %.1f us, 1-bit tamper caught  %s\n",
                g_mac_us, (good && caught) ? "PASS" : "FAIL");
    }
    DES_LOG("\n");
    return ok;
}

// Application-level round trip, so the transport's cost can be compared against
// the homomorphic cost with real numbers rather than quoted ones.
static void probe_rtt() {
    if (DES_NODE_ID != 1 || DES_NUM_NODES < 2) return;
    DES_LOG("--- transport round-trip probe (%s) ---\n", DES_TRANSPORT_IMPL.name);
    uint64_t tot = 0, mn = UINT64_MAX, mx = 0; int got = 0;
    for (int i = 0; i < 20; ++i) {
        uint64_t t0 = des_micros();
        tx(M_PING, 0, (uint32_t)i);
        uint32_t want = 0;
        for (int n = 2; n <= DES_NUM_NODES; ++n) want |= 1u << (n-1);
        if (collect(M_PONG, (uint32_t)i, want, 300, nullptr) == want) {
            uint64_t d = des_micros() - t0;
            tot += d; if (d < mn) mn = d; if (d > mx) mx = d; ++got;
        }
        pump_delay(20);
    }
    if (got) DES_LOG("  %d probes: avg %.2f ms  min %.2f ms  max %.2f ms\n\n",
                     got, (tot/(double)got)/1000.0, mn/1000.0, mx/1000.0);
    else     DES_LOG("  no reply — are the other nodes running?\n\n");
}


// =============================================================================
// 16. Benchmark driver — walks the generated SIM_SEQ
// =============================================================================
//
// Each node walks the same generated sequence but fires only the events it
// owns, waiting until its encrypted supervisors enable them. Events owned by
// other nodes are waited for only if they concern us, and shared events are
// where the nodes meet (see await_participants).

// Why the last drive_one() failed, for the SKIP line. It used to print "my
// supervisor disables it" whatever the cause, which blamed this node for a
// peer's veto.
static const char* g_drive_why = "";

// Fire one event we own, waiting until our supervisors (and, for shared events,
// our peers) allow it. Returns false if it never became admissible in time.
static bool drive_one(int gi, uint32_t occ, uint32_t timeout_ms) {
    const EvRoute& r = g_route[gi];
    char nm[16]; ev_name(gi, nm);
    // Machines take time: a<i> starts the work, b<i> reports it done.
    if (!r.controllable) pump_delay(DES_WORK_MS);

    uint32_t t0 = des_millis(), spins = 0;
    uint32_t backoff = 50;                        // grows while a veto stands
    FireResult last = FIRE_OK;
    g_veto_ev = -1; g_veto_repeat = 0;
    while (!g_safe_halt) {
        pump();
        // A controllable event my supervisors disable may become allowed once
        // the plant moves on, so it is waited for. An uncontrollable one goes
        // straight to fire(): by the time this node reaches the step, every
        // earlier event that concerns its supervisors has been applied, so a
        // disabled one is impossible, and fire() rejects it at once.
        if (r.controllable && !local_enabled(gi)) {
            des_sleep_ms(5);
            if (des_millis() - t0 > timeout_ms) {
                g_drive_why = "my own supervisor disables it here";
                return false;
            }
            continue;
        }
        uint64_t he = 0, net = 0, a0 = des_micros();
        FireResult fr = fire(gi, occ, &he, &net);
        if (fr == FIRE_OK) {
            uint64_t wall = des_micros() - a0;
            if (!r.shared)           g_acc_local .add(he, net, wall);
            else if (r.controllable) g_acc_ctrl  .add(he, net, wall);
            else                     g_acc_unctrl.add(he, net, wall);
            if (g_veto_repeat) {
                DES_STEP_TAG();
                DES_LOG("veto   %-4s  refused %u more time%s over %.1f s, then "
                        "allowed\n", nm, (unsigned)g_veto_repeat,
                        g_veto_repeat == 1 ? "" : "s", (des_millis()-t0)/1000.0);
            }
            return true;
        }
        if (fr == FIRE_HALT) { g_drive_why = "safe halt"; return false; }
        if (fr == FIRE_IMPOSSIBLE) { g_drive_why = g_block_why; return false; }
        last = fr;

        // A veto is a decision, not a dropped packet. Only a state change on
        // the vetoing peer can lift it, and that peer learns of state changes
        // from frames it must have room to receive — so hammering it with
        // requests actively prevents the thing we are waiting for. Back off
        // geometrically to a full second; a quorum failure, which really is
        // transient, keeps the short retry.
        if (fr == FIRE_VETOED) {
            des_sleep_ms(backoff);
            if (backoff < 1000) backoff = backoff * 2 > 1000 ? 1000 : backoff * 2;
        } else {
            des_sleep_ms(r.shared ? 50 : 5);
        }
        if (des_millis() - t0 > timeout_ms) {
            if (g_veto_repeat) {
                DES_STEP_TAG();
                DES_LOG("veto   %-4s  refused %u more time%s over %.1f s, giving "
                        "up\n", nm, (unsigned)g_veto_repeat,
                        g_veto_repeat == 1 ? "" : "s", (des_millis()-t0)/1000.0);
            }
            g_drive_why = last == FIRE_VETOED ? "a PEER's supervisor kept vetoing it"
                                              : g_block_why;
            return false;
        }
        if (++spins % 200 == 0) {
            DES_STEP_TAG();
            DES_LOG("wait   %-4s  still blocked after %.1f s\n",
                    nm, (des_millis()-t0)/1000.0);
        }
    }
    return false;
}

// How long an owner waits for its participants to REACH a shared step before
// giving up on it. Generous on purpose: this is the plant catching up, not a
// network fault, and on FMS the board holding S4/S5/S6 needs ~15 s to walk
// the local events that separate two shared ones.
#ifndef DES_SYNC_TIMEOUT_MS
#define DES_SYNC_TIMEOUT_MS 60000
#endif

// The plant half of a synchronous product.
//
// In the synchronous composition every plant model in this repo is built
// from, a shared event occurs only when EVERY component that has it in its
// alphabet is ready to take it. The two-phase commit only answers half of
// that: a participant's vote says its SUPERVISOR allows the event. Whether
// its part of the PLANT has got there yet — whether the machine the event
// belongs to has finished what precedes it in the trace — the vote does not
// say, because a supervisor may well allow an event the plant is not ready to
// produce.
//
// On one board the question never comes up: a single CPU walks the trace in
// order. Distributed, it is the whole problem. Without this rendezvous the
// fast node fires shared events into a peer that is still seconds behind in
// its own part of the trace; the peer's supervisor then either vetoes (it
// really is not ready), or accepts an event out of the trace's order, and
// either way the replay stops being the trace it was generated as. Measured
// on two ESP32-S3 running FMS: 95 of 220 steps skipped on one node, 34 on the
// other, zero frames lost.
//
// So each participant announces `M_AT(ev, occ)` when its own walk reaches the
// step, and the owner does not fire until every participant has said so.
// Every node walks the same trace and waits only for positions at or before
// its own, so no cycle of waits can form.
static bool await_participants(int gi, uint32_t occ) {
    uint32_t need = g_route[gi].part_mask;
    uint64_t t0 = des_micros();
    uint32_t m0 = des_millis(), mlog = m0;
    for (;;) {
        pump();
        uint32_t have = 0;
        for (int n = 1; n <= DES_NUM_NODES; ++n)
            if ((need >> (n - 1) & 1) && g_at_occ[n][gi] >= occ) have |= 1u << (n - 1);
        if (have == need) break;
        if (g_safe_halt) return false;
        if (des_millis() - m0 > DES_SYNC_TIMEOUT_MS) return false;
        if (des_millis() - mlog > 10000) {
            mlog = des_millis();
            char nm[16];
            DES_STEP_TAG();
            DES_LOG("sync   %-4s  waiting for peers to reach this step (%.0f s)\n",
                    ev_name(gi, nm), (des_millis() - m0) / 1000.0);
        }
        des_sleep_ms(2);
    }
    g_sync_us += des_micros() - t0; ++g_sync_n;
    return true;
}

#ifdef DES_INJECT_EVENT
// Plant-check demonstration (see DES_INJECT_EVENT): the question a real sensor
// report of the event would face at this point, asked without applying it.
static void inject_test() {
    int gi = -1; char nm[16];
    for (int g = 0; g < EVENT_COUNT; ++g)
        if (!strcmp(ev_name(g, nm), DES_INJECT_EVENT)) gi = g;
    if (gi < 0) {
        DES_LOG("[test] DES_INJECT_EVENT \"%s\" is not an event of this problem\n",
                DES_INJECT_EVENT);
        return;
    }
    if (!i_am_owner(gi)) return;            // its sensor reports to its owner
    bool ok = local_enabled(gi);
    DES_STEP_TAG();
    DES_LOG("[test] fake report of %s (%s): %s\n", DES_INJECT_EVENT,
            g_route[gi].controllable ? "controllable" : "uncontrollable",
            ok ? "ACCEPTED — the supervisors allow it here"
               : "REJECTED — no machine could produce it here");
}
#endif

// Replay the generated SIM_SEQ. Every node walks the same sequence but fires
// only the events it owns, and meets its peers at the shared ones. Steps that
// are not admissible are reported and skipped rather than forced — firing a
// disabled transition would silently corrupt every supervisor downstream.
static void run_benchmark() {
    DES_LOG("============================================================\n");
    DES_LOG("  RUN — SIM_SEQ driver — %d cycles x %d steps — %s\n",
            (int)DES_ROUNDS, (int)SIM_SEQ_LEN, DES_FAMILY_NAME);
    DES_LOG("  columns: cN sNN = cycle/step of MY walk; · = a peer caused this\n");
    DES_LOG("  'done at': run clock, common to all nodes; a cycle is over at the\n");
    DES_LOG("  LATEST node's print, machine time (DES_WORK_MS %d) included\n",
            (int)DES_WORK_MS);
    DES_LOG("============================================================\n");
    if (DES_NODE_ID == 1 || !g_run_t0) g_run_t0 = des_micros();

    // occ_ctr[gi] = how many times gi has appeared so far. Identical on every
    // node, because every node walks the identical trace.
    static uint32_t occ_ctr[EVENT_COUNT];
    memset(occ_ctr, 0, sizeof(occ_ctr));

    for (int round = 1; round <= DES_ROUNDS && !g_safe_halt; ++round) {
        g_cycle = round;
        DES_LOG("\n-- cycle %d/%d --\n", round, (int)DES_ROUNDS);
        for (int p = 0; p < SIM_SEQ_LEN && !g_safe_halt; ++p) {
            int gi = (int)pm_u16(SIM_SEQ, p);
            char nm[16]; ev_name(gi, nm);
            uint32_t occ = ++occ_ctr[gi];
            g_step = p;
            const EvRoute& r = g_route[gi];
#ifdef DES_INJECT_EVENT
            if (round == 1 && p == DES_INJECT_AT_STEP) inject_test();
#endif

            if (i_am_owner(gi)) {
                bool ok = true;
                if (r.shared && !await_participants(gi, occ)) {
                    ok = false;
                    g_drive_why = "a peer never reached this step";
                }
                if (ok) ok = drive_one(gi, occ, DES_STEP_TIMEOUT_MS);
                if (!ok && !g_safe_halt) {
                    ++g_skips;
                    g_resolved_occ[gi] = occ;
                    // Tell whoever is waiting on it. Three copies, because a
                    // lost SKIP costs a peer its whole timeout and a duplicate
                    // costs nothing — the handler is idempotent.
                    if (r.shared || DES_BENCH_LOCKSTEP)
                        for (int k = 0; k < 3; ++k) tx(M_SKIP, (uint8_t)gi, 0, 0, occ);
                    DES_STEP_TAG();
                    DES_LOG("SKIP   %-4s  %s\n", nm, g_drive_why);
                }
                continue;
            }

            // Not ours. Participants learn of it through COMMIT/NOTIFY, everyone
            // else (lockstep only) through ANNOUNCE.
            bool part = i_participate(gi);
            if (!part && !DES_BENCH_LOCKSTEP) continue;

            // LEVEL-triggered: "has occurrence `occ` been resolved yet?", not
            // "did a counter move while I was watching?". An event that landed
            // before this wait began — because the peer got here first — is
            // already resolved and costs no time at all.
            uint32_t t0 = des_millis(), tat = 0;
            while (g_resolved_occ[gi] < occ && !g_safe_halt) {
                if (part && (tat == 0 || des_millis() - tat > 300)) {
                    tx(M_AT, (uint8_t)gi, 0, 0, occ);
                    tat = des_millis();
                }
                pump(); des_sleep_ms(2);
                if (des_millis() - t0 > 2 * DES_SYNC_TIMEOUT_MS) {
                    DES_STEP_TAG();
                    DES_LOG("wait   %-4s  node %d never resolved it in %.0f s — "
                            "moving on\n", nm, (int)r.owner,
                            (2 * DES_SYNC_TIMEOUT_MS) / 1000.0);
                    break;
                }
            }
        }
        if (!g_safe_halt) {
            g_cycle_end_ms[g_cycles_done++] = (des_micros() - g_run_t0) / 1000.0;
            DES_LOG("-- cycle %d/%d done at %.1f ms --\n", round, (int)DES_ROUNDS,
                    g_cycle_end_ms[g_cycles_done - 1]);
        }
    }
    print_summary();
}

// =============================================================================
// 17. Entry points
// =============================================================================

static void des_setup() {
    DES_LOG("\n============================================================\n");
    DES_LOG("  Distributed Homomorphic DES — generic engine\n");
    DES_LOG("  node %d/%d   family %s   %d supervisors   %d events\n",
            (int)DES_NODE_ID, (int)DES_NUM_NODES, DES_FAMILY_NAME,
            (int)DES_NSUPS, (int)EVENT_COUNT);
    DES_LOG("  data: %s\n", DES_DATA_HEADER);
    DES_LOG("============================================================\n");

    crypto_init();
    // Any nonzero value that differs across boots will do; the DRBG is already
    // seeded from the hardware entropy source.
    // Bounded: a DRBG that failed to seed returns an error and writes nothing,
    // and an unbounded retry would hang the board before its first log line.
    for (int k = 0; k < 8 && !g_epoch; ++k)
        mbedtls_ctr_drbg_random(&g_drbg, (unsigned char*)&g_epoch, sizeof(g_epoch));
    if (!g_epoch) g_epoch = (uint32_t)des_micros() | 1u;
    // A node that fails to come up must not keep answering its peers — it
    // would vote YES from supervisors it never initialised. Halting also tells
    // them so. (safe_halt's broadcast is harmless if the transport is down.)
    if (!partition_ok()) { safe_halt("invalid DES_SUP_NODE_MAP"); return; }
    build_routing();
    g_cfg = config_fingerprint();
    print_partition();
    DES_LOG("[init] config fingerprint %08x — every node must print the same\n\n",
            (unsigned)g_cfg);

    if (!DES_TRANSPORT_IMPL.begin()) {
        DES_LOG("[FATAL] transport '%s' failed to start\n", DES_TRANSPORT_IMPL.name);
        safe_halt("transport failed to start");
        return;
    }
    if (!run_selftest()) { safe_halt("crypto self-test failed"); return; }

    DES_LOG("--- encrypting my supervisors' initial states ---\n");
    load_my_supervisors();
    if (!init_states()) { safe_halt("encryption of the initial state failed"); return; }
    warm_cache();

    g_oracle.resize(g_sups.size());
    for (size_t i = 0; i < g_sups.size(); ++i) g_oracle[i].init(g_sups[i].desc);
#if DES_MONO_ACTIVE
    g_mono.init(&MONO_SUP);
#endif
    oracle_verify("init");
    DES_LOG("[init] my keypair is mine alone; no ciphertext ever leaves this node\n");
    { char nm[16]; DES_LOG("[init] my enablement:");
      for (int gi = 0; gi < EVENT_COUNT; ++gi)
          DES_LOG(" %s=%d", ev_name(gi, nm), (int)local_enabled(gi));
      DES_LOG("\n\n"); }

    // Rendezvous: beacon until every other node has been heard from.
    uint32_t want = 0;
    for (int n = 1; n <= DES_NUM_NODES; ++n) if (n != DES_NODE_ID) want |= 1u << (n-1);
    if (want) {
        // Wait for EVERY peer, however long it takes. Starting without them is
        // not a degraded run, it is a meaningless one: this node would fire and
        // announce events the absent peers never see, and when they finally
        // join they would be behind by exactly those events and safe-halt on
        // the first shared one. Flashing the second board simply takes longer
        // than any fixed timeout worth having, so there is nothing to time out
        // on. DES_RENDEZVOUS_MS now only sets how often the reminder prints.
        DES_LOG("[net] waiting for %d peer(s)", __builtin_popcount(want));
        uint32_t t0 = des_millis();
        // g_peer_seen only counts frames from peers with OUR configuration —
        // a mismatched one is dropped in he_yield() and never "present".
        while ((g_peer_seen & want) != want) {
            tx(M_HELLO, 0, 0);
            pump_delay(200);
            DES_LOG(".");
            if (des_millis() - t0 >= DES_RENDEZVOUS_MS) {
                t0 = des_millis();
                DES_LOG("\n[net] still waiting for node");
                for (int n = 1; n <= DES_NUM_NODES; ++n)
                    if ((want >> (n-1) & 1) && !(g_peer_seen >> (n-1) & 1))
                        DES_LOG(" %d", n);
                DES_LOG(" — power it on, or set DES_NUM_NODES to run alone\n");
            }
        }
        DES_LOG(" all present.\n");
        // Keep saying hello for a moment. A node that hears its peers before
        // it has sent anything would otherwise leave this loop without ever
        // having announced itself, and they would wait on it.
        for (int k = 0; k < 5; ++k) { tx(M_HELLO, 0, 0); pump_delay(300); }
    }
    DES_LOG("\n");

    probe_rtt();

    // Zero the receive-queue statistics so the summary describes the measured
    // run and not the rendezvous, where HELLO frames are broadcast deliberately
    // faster than they are consumed and a full queue means nothing.
    g_rxq_drops = 0; g_rxq_peak = 0;
    run_benchmark();
}

static void des_loop() {
    // Keep serving peers after the benchmark: they may still be retransmitting
    // and need their ACKs, and a late SAFE HALT must still propagate.
    pump();
    des_sleep_ms(20);
}
