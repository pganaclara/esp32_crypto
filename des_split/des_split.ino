// =============================================================================
// des_split.ino — supervisor and plant on two ESP32 boards
// =============================================================================
//
// One board is the PLANT: it emulates the plant by replaying the trace of the
// header and decrypts the decisions. The other is the SUPERVISOR: it holds the
// supervisor's tables and its encrypted state, and never sees an event or a
// decision. The private key is split between the two boards, so neither can
// decrypt anything alone. The logic is in des_split.h; this file only picks
// the deployment and brings up the Wi-Fi.
//
// ── CONFIGURE PER BOARD ──────────────────────────────────────────────────────
// Flash one board with DES_ROLE DES_PLANT and the other with DES_SUPERVISOR,
// from the same header. Open both Serial Monitors, then RESET both boards.
// =============================================================================

// ── 1. which problem, which curve ───────────────────────────────────────────
// A header generated by the UltraDES notebook, with the monolithic supervisor:
//   supervisor_data_cluster_tool_2.h   14 events,  45 states
//   supervisor_data_cluster_tool_3.h   22 events, 419 states
//   supervisor_data_cluster_tool_4.h   30 events, 4184 states: needs PSRAM on
//                                      both boards (Tools → PSRAM → OPI PSRAM)
#define DES_DATA_HEADER "supervisor_data_cluster_tool_2.h"
// NIST P-192, P-224 or P-256: about 96, 112 or 128 bits of security.
#define DES_CURVE 256

// ── 2. this board ───────────────────────────────────────────────────────────
#define DES_ROLE DES_PLANT          // DES_PLANT or DES_SUPERVISOR — ONE OF EACH

// ── 3. network: UDP/IP multicast (RFC 1112) ─────────────────────────────────
// Another port than des_distributed, so the two never hear each other.
#define DES_MCAST_GROUP "239.192.7.1"
#define DES_MCAST_PORT  5078

// ── 4. credentials: Wi-Fi and the boards' identity keys ─────────────────────
// secrets.h is not versioned (.gitignore): the Wi-Fi (as in des_distributed's
// secrets.h) and one identity key per board, made by make_keys.py:
//     python make_keys.py >> secrets.h
// Both boards are built from the same secrets.h; each compiles in only its own
// private key and the other's public key.
#if __has_include("secrets.h")
#  include "secrets.h"
#else
#  error "secrets.h is missing: see secrets.example.h"
#endif

// =============================================================================

#include <Arduino.h>
#include <WiFi.h>

#include "des_split.h"

static void link_up() {
    Serial.printf("[link] joining '%s'", WIFI_SSID);
    WiFi.mode(WIFI_STA);
    WiFi.begin(WIFI_SSID, WIFI_PASS);
    uint32_t t0 = millis();
    while (WiFi.status() != WL_CONNECTED && millis() - t0 < 30000) {
        delay(400); Serial.print(".");
    }
    if (WiFi.status() != WL_CONNECTED) {
        Serial.println(" FAILED: check WIFI_SSID / WIFI_PASS in secrets.h.");
        return;
    }
    Serial.printf(" ok — %s\n", WiFi.localIP().toString().c_str());
    WiFi.setSleep(false);           // multicast on a sleeping station drops frames
}

// des_transport.h asks the platform which interface to join the group on.
static uint32_t des_local_ipv4() {
    return (uint32_t)WiFi.localIP();
}

void setup() {
    Serial.begin(115200);
    delay(1500);
    link_up();
    split_setup();
}

void loop() {
    split_loop();

    // USB CDC does not replay what was printed before the Serial Monitor was
    // opened: type anything to reprint the summary.
    if ((g_done || g_halt) && Serial.available()) {
        while (Serial.available()) Serial.read();
        print_summary();
    }
}
